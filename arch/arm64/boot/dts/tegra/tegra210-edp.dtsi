/ {
	cpu_edp: cpu-edp {
		compatible = "nvidia,tegra124-cpu-edp-capping";
		nvidia,freq-step = <19200000>;
		nvidia,tegra-ppm-cdyn = <950000 1425000 2650000 3125000>;
		nvidia,tegra-ppm-leakage_weights = <470 670 890 1050>;
		nvidia,tegra-ppm-min_leakage = <30>;
		nvidia,tegra-ppm-coeff_scale = <1000>;
		nvidia,tegra-ppm-leakage_coeffs = <
			(-3659484) (-3057294) (1608816) (-130989)
			(0) (16683670) (-6372503) (485507)
			(14655002) (-26112773) (8205917) (-591269)
			(-10647137) (12310458) (-3409306) (234894)
			(-7870522) (9114646) (-2628260) (184970)
			(37697412) (-36540739) (9732641) (-663683)
			(-55266862) (47580771) (-11862699) (786028)
			(25060188) (-19917376) (4713214) (-304265)
			(6898136) (-5246483) (1212138) (-78791)
			(-26152713) (19228121) (-4319724) (276509)
			(32507089) (-23196812) (5075934) (-320077)
			(-13139773) (9150717) (-1955349) (121584)
			(-816630) (570621) (-123575) (7766)
			(2973598) (-2042153) (434622) (-27022)
			(-3565514) (2408959) (-504033) (31003)
			(1398871) (-931712) (191840) (-11679)
		>;

		nvidia,tz = <&cpu_therm>;
	};

	cpu-edp-cdev-cap {
		compatible = "nvidia,tegra124-cpu-edp-cdev-action";
		act-dev = <&cpu_edp>;
		cdev-type = "CPU-EDP-cap";

		#cooling-cells = <2>; /* min followed by max */
	};
};

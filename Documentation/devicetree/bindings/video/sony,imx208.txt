## chromeos/drivers/ath6kl/Kconfig
```kconfig
config ATH6K_LEGACY
	tristate "Atheros AR600x support (non mac80211)"
	depends on MMC
	depends on WLAN_80211
	depends on CFG80211
	help
	This module adds support for wireless adapters based on Atheros AR600x chipset running over SDIO. If you choose to build it as a module, it will be called ath6kl.

choice
	prompt "AR600x Version"
	depends on ATH6K_LEGACY
	default AR6003_HW10
	help
	Select the appropriate configuration from the list below that matches your AR600x based reference design.

config AR6003_HW10
	bool "AR6003, Rev 1.0"
	help
        AR6003 1.0 silicon

config AR6003_HW20
	bool "AR6003, Rev 2.0"
	help
        AR6003 2.0 silicon
endchoice

choice
	prompt "AR600x Configuration"
	depends on ATH6K_LEGACY
	default AR600x_SD31_XXX
	help
	Select the appropriate configuration from the list below that matches your AR600x based reference design.

config AR600x_SD31_XXX
	bool "SD31-xxx"
	help
        Board Data file for a standard SD31 reference design (File: bdata.SD31.bin)

config AR600x_WB31_XXX
	bool "WB31-xxx"
	help
        Board Data file for a standard WB31 (BT/WiFi) reference design (File: bdata.WB31.bin)

config AR600x_SD32_XXX
	bool "SD32-xxx"
	help
        Board Data file for a standard SD32 (5GHz) reference design (File: bdata.SD32.bin)

config AR600x_CUSTOM_XXX
	bool "CUSTOM-xxx"
	help
        Board Data file for a custom reference design (File: should be named as bdata.CUSTOM.bin)
endchoice

config ATH6KL_HCI_BRIDGE
	bool "HCI over SDIO support"
	depends on ATH6K_LEGACY
	help
	Enables BT over SDIO. Applicable only for combo designs (eg: WB31)

config ATH6KL_CFG80211
	bool "CFG80211 support"
	depends on ATH6K_LEGACY
	help
	Enables support for CFG80211 APIs

config ATH6KL_HTC_RAW_INTERFACE
	bool "RAW HTC support "
	depends on ATH6K_LEGACY
	help
	Enables raw HTC interface. Allows application to directly talk to the HTC interface via the ioctl interface

config ATH6KL_DEBUG
	bool "Debug support"
	depends on ATH6K_LEGACY
	help
	Enables debug support in the driver
```

## chromeos/drivers/iio/Kconfig
```kconfig
#
# Industrial I/O subsytem configuration
#

menuconfig IIO
	tristate "Industrial I/O support"
	depends on !S390
	---help---
	  The industrial I/O subsystem provides a unified framework for
	  drivers for many different types of embedded sensors using a
	  number of different physical interfaces (i2c, spi, etc). See
	  Documentation/industrialio for more information.
if IIO

source "chromeos/drivers/iio/light/Kconfig"

endif # IIO
```

## chromeos/drivers/rtl8103/Kconfig
```kconfig
config R8103
	tristate "Realtek 8103 gigabit ethernet support"
	depends on PCI
	select CRC32
	select MII
	---help---
	  Say Y here if you have a Realtek 8103 PCI Gigabit Ethernet adapter.

	  To compile this driver as a module, choose M here: the module
	  will be called r8103.  This is recommended.
```

## chromeos/drivers/usb-server/modules/src/tusbd2.6.31/Kconfig
```kconfig
config TUSBD_USB_OVER_IP
	tristate "USB-over-IP driver from http://www.incentivespro.com/product.html"
	help
	This module adds USB-over-IP support.  
```

## drivers/gpu/drm/bridge/Kconfig
```kconfig
config DRM_PARADE_PS8640
	tristate "Parade PS8640 MIPI DSI to eDP Converter"
	depends on OF && I2C
	select DRM_KMS_HELPER
	select DRM_MIPI_DSI
	select DRM_PANEL
	---help---
	  Choose this option if you have PS8640 for display
	  The PS8640 is a high-performance and low-power
	  MIPI DSI to eDP converter

config DRM_PTN3460
	tristate "PTN3460 DP/LVDS bridge"
	depends on DRM
	select DRM_KMS_HELPER
	---help---
```

## drivers/gpu/drm/img-rogue/Kconfig
```kconfig
config DRM_POWERVR_ROGUE
	tristate "PowerVR Rogue"
	depends on ARM || ARM64 || X86 || METAG || MIPS
	depends on HAS_IOMEM
	depends on DRM
	select DRM_KMS_HELPER
	select PM_DEVFREQ
	select DEVFREQ_GOV_SIMPLE_ONDEMAND
	select PM_OPP
	select DEVFREQ_THERMAL
	help
	  Driver for PowerVR Rogue graphics hardware.

	  Say Y here if your SoC contains a PowerVR Rogue GPU. For more
	  information, see <http://www.imgtec.com/powervr/>.

config DRM_POWERVR_ROGUE_DEBUG
	bool "Enable PowerVR Rogue debug features"
	depends on DRM_POWERVR_ROGUE
	default n
	help
	  Add additional debug features to the PowerVR Rogue driver.

config DRM_POWERVR_ROGUE_KERNEL_SRVINIT
	bool "Enable PowerVR Rogue in-kernel firmware load."
	depends on DRM_POWERVR_ROGUE
	default n
	help
	  Enable in-kernel firmware load.

config DRM_POWERVR_ROGUE_PDUMP
	bool "Enable PowerVR Rogue PDUMP tracing."
	depends on DRM_POWERVR_ROGUE
	default n
	help
	  Enable PDUMP.
```

## drivers/gpu/drm/tegra/Kconfig
```kconfig
config DRM_TEGRA
	tristate "NVIDIA Tegra DRM"
	depends on ARCH_TEGRA || (ARM && COMPILE_TEST)
	depends on COMMON_CLK
	depends on DRM
	depends on RESET_CONTROLLER
	select DRM_HDCP
	select DRM_KMS_HELPER
	select DRM_MIPI_DSI
	select DRM_PANEL
	select TEGRA_HOST1X
	help
	  Choose this option if you have an NVIDIA Tegra SoC.

	  To compile this driver as a module, choose M here: the module
	  will be called tegra-drm.

config NVDEC_BOOTLOADER
	bool "Enable use of nvdec bootloader"
	help
	  This config enables nvdec driver to load BL (Boot Loader) and
	  LS (Low Security) firmwares. BL firmware performs security checks
	  required to decode secure content from netflix, widevine etc. before
	  loading LS firmware.  Say N here if you want to disable nvdec
	  bootloader and decode only clear/non-secure content.

	  If unsure, say N

if DRM_TEGRA

config DRM_TEGRA_FBDEV
	bool "Enable legacy fbdev support"
	select DRM_KMS_FB_HELPER
	select FB_SYS_FILLRECT
	select FB_SYS_COPYAREA
	select FB_SYS_IMAGEBLIT
	default y
	help
	  Choose this option if you have a need for the legacy fbdev support.
	  Note that this support also provides the Linux console on top of
	  the Tegra modesetting driver.

config DRM_TEGRA_DEBUG
	bool "NVIDIA Tegra DRM debug support"
	help
	  Say yes here to enable debugging support.

config DRM_TEGRA_STAGING
	bool "Enable HOST1X interface"
	depends on STAGING
	help
	  Say yes if HOST1X should be available for userspace DRM users.

	  If unsure, choose N.

endif

source "drivers/gpu/drm/tegra/camera/Kconfig"
```

## drivers/gpu/drm/tegra/camera/Kconfig
```kconfig
config DRM_TEGRA_CAMERA_IMX219
        tristate "IMX219 camera sensor support"
        depends on I2C && ARCH_TEGRA
        ---help---
         This is a driver for the IMX219
         camera sensor for use with the tegra isp.
         The sensor has a maximum of 8MP
         resolution.

config DRM_TEGRA_CAMERA_IMX208
        tristate "IMX208 camera sensor support"
        depends on I2C && ARCH_TEGRA
        ---help---
         This is a driver for the IMX208
         camera sensor for use with the tegra isp.
         The sensor has a maximum of 2MP
         resolution.

config DRM_TEGRA_CAMERA_AD5823
        tristate "AD5823 focuser support"
        depends on I2C && ARCH_TEGRA
        ---help---
          This is a driver for the AD5823 focuser
          for use with the tegra isp.
```

## drivers/iio/common/Kconfig
```kconfig
#
# IIO common modules
#

source "drivers/iio/common/cros_ec_sensors/Kconfig"
source "drivers/iio/common/hid-sensors/Kconfig"
source "drivers/iio/common/st_sensors/Kconfig"
```

## drivers/memory/tegra/Kconfig
```kconfig
config TEGRA_MC
	bool "NVIDIA Tegra Memory Controller support"
	default y
	depends on ARCH_TEGRA
	help
	  This driver supports the Memory Controller (MC) hardware found on
	  NVIDIA Tegra SoCs.

config TEGRA124_EMC
	bool "Tegra124 External Memory Controller(EMC) driver"
	default y
	depends on BROKEN
	depends on MFD_SYSCON && (ARCH_TEGRA_124_SOC || ARCH_TEGRA_132_SOC)
	help
	  This driver is for the External Memory Controller(EMC) module
	  available in Tegra124 SoCs.

config TEGRA210_EMC
	bool "Tegra210 External Memory Controller(EMC) driver"
	default y
	depends on ARCH_TEGRA_210_SOC
	help
	  This driver is for the External Memory Controller(EMC) module
	  available in Tegra210 SoCs.
```

## drivers/net/wireless-3.8/Kconfig
```kconfig
# Wireless LAN device configuration
#

menuconfig WLAN
	bool "Wireless LAN"
	depends on !S390
	depends on NET
	select WIRELESS
	default y
	---help---
	  This section contains all the pre 802.11 and 802.11 wireless
	  device drivers. For a complete list of drivers and documentation
	  on them refer to the wireless wiki:

	  http://wireless.kernel.org/en/users/Drivers

if WLAN

source "drivers/net/wireless-3.8/iwl7000/Kconfig"

endif # WLAN
```

## drivers/nvmem/Kconfig
```kconfig
menuconfig NVMEM
	tristate "NVMEM Support"
	select REGMAP
	help
	  Support for NVMEM(Non Volatile Memory) devices like EEPROM, EFUSES...

	  This framework is designed to provide a generic interface to NVMEM
	  from both the Linux Kernel and the userspace.

	  This driver can also be built as a module. If so, the module
	  will be called nvmem_core.

	  If unsure, say no.

if NVMEM

config MTK_EFUSE
	tristate "Mediatek SoCs EFUSE support"
	depends on ARCH_MEDIATEK || COMPILE_TEST
	select REGMAP_MMIO
	help
	  This is a driver to access hardware related data like sensor
	  calibration, HDMI impedance etc.

	  This driver can also be built as a module. If so, the module
	  will be called efuse-mtk.

config QCOM_QFPROM
	tristate "QCOM QFPROM Support"
	depends on ARCH_QCOM || COMPILE_TEST
	select REGMAP_MMIO
	help
	  Say y here to enable QFPROM support. The QFPROM provides access
	  functions for QFPROM data to rest of the drivers via nvmem interface.

	  This driver can also be built as a module. If so, the module
	  will be called nvmem_qfprom.

config NVMEM_SUNXI_SID
	tristate "Allwinner SoCs SID support"
	depends on ARCH_SUNXI
	select REGMAP_MMIO
	help
	  This is a driver for the 'security ID' available on various Allwinner
	  devices.

	  This driver can also be built as a module. If so, the module
	  will be called nvmem_sunxi_sid.

endif
```

## drivers/platform/chrome/Kconfig
```kconfig
#
# Platform support for Chrome OS hardware (Chromebooks and Chromeboxes)
#

menuconfig CHROME_PLATFORMS
	bool "Platform support for Chrome hardware"
	---help---
	  Say Y here to get to see options for platform support for
	  various Chromebooks and Chromeboxes. This option alone does
	  not add any kernel code.

	  If you say N, all options in this submenu will be skipped and disabled.

if CHROME_PLATFORMS

config CHROMEOS
	bool
	depends on CHROMEOS_OF_FIRMWARE || (NVRAM && ACPI_CHROMEOS)

	---help---
	  Provides abstracted interfaces to the firmware features provided on
	  ChromeOS devices. It depends on a lowlevel driver to implement the
	  firmware interface on the platform.

config CHROMEOS_OF_FIRMWARE
	bool "ChromeOS firmware interface driver"
	depends on OF
	select CHROMEOS
	select CHROMEOS_VBC_EC
	---help---
	  This driver provides an interface to ChromeOS firmware.

	  Say Y here if you are building for a ChromeOS device.

config CHROMEOS_LAPTOP
	tristate "Chrome OS Laptop"
	depends on I2C && DMI && X86
	---help---
	  This driver instantiates i2c and smbus devices such as
	  light sensors and touchpads.

	  If you have a supported Chromebook, choose Y or M here.
	  The module will be called chromeos_laptop.

config CHROMEOS_PSTORE
	tristate "Chrome OS pstore support"
	depends on X86
	---help---
	  This module instantiates the persistent storage on x86 ChromeOS
	  devices. It can be used to store away console logs and crash
	  information across reboots.

	  The range of memory used is 0xf00000-0x1000000, traditionally
	  the memory used to back VGA controller memory.

	  If you have a supported Chromebook, choose Y or M here.
	  The module will be called chromeos_pstore.

config CHROMEOS_VBC_EC
	bool
	depends on CHROMEOS
	select MFD_CROS_EC

	---help---
	  Provides access to vboot context stored on EC's nvram.  Select this
	  if you have a ChromeOS firmware that supports storing vboot context
	  in EC's nvram.

endif # CHROMEOS_PLATFORMS
```

## drivers/soc/tegra/Kconfig
```kconfig
config TEGRA_BPMP_MAILMAN
	bool "Mailman driver for Tegra BPMP-lite mailbox"
	depends on ARCH_TEGRA_210_SOC
	depends on TEGRA_BPMP_MBOX
	default y
	help
	  Say y here to support Tegra's BPMP-lite mailman driver.
	  If unsure say N.

config TEGRA_PROC_POWER_MODEL
	bool "Tegra process power model support"
	depends on ARCH_TEGRA
	help
	  A simple model of processor power relating voltage, frequency,
	  cores, and chip specific data. Used by various drivers.

config TEGRA_CPU_EDP
	bool "Enforce electrical design limits on CPU rail (CPU EDP)"
	depends on ARCH_TEGRA
	depends on CPU_FREQ && THERMAL
	default n
	select TEGRA_PROC_POWER_MODEL
	help
	  Enforce electrical design limits on CPU rail.
	  VDD_CPU EDP prevents the CPU from drawing more current than
	  its voltage regulator can supply.
	  Limit maximum CPU frequency based on temperature and number
	  of on-line CPUs to keep CPU rail current within power supply
	  capabilities.

config TEGRA_DVFS
	bool
	depends on ARCH_TEGRA
	help
	  This adds Tegra DVFS support. There could be several power
	  rails involved and there might be rails dependency based
	  on different SoCs, this config enable the generic DVFS
	  library needed by each SoCs DVFS files.

	  If in doubt, say N.

config TEGRA_124_DVFS
	bool "Tegra124 DVFS support"
	depends on ARCH_TEGRA_124_SOC
	select TEGRA_DVFS
	help
	  This enable Tegra124 DVFS functionality, it implements SoC
	  specific initialization code to be invoked by probe function
	  defined in generic Tegra DVFS driver, so while enabled it
	  needs the config TEGRA_DVFS to be enabled as well.

config TEGRA_210_DVFS
	bool "Tegra210 DVFS support"
	depends on ARCH_TEGRA_210_SOC
	select TEGRA_DVFS
	help
	  This enable Tegra210 DVFS functionality, it implements SoC
	  specific initialization code to be invoked by probe function
	  defined in generic Tegra DVFS driver, so while enabled it
	  needs the config TEGRA_DVFS to be enabled as well.

source "drivers/soc/tegra/sysedp/Kconfig"
```

## drivers/staging/iio/light/Kconfig
```kconfig
#
# Light sensors
#
comment "Light sensors"

config SENSORS_TSL2563
	tristate "TAOS TSL256[0-3] ambient light sensor"
	depends on I2C
	help
	 If you say yes here you get support for the Taos TSL2560,
	 TSL2561, TSL2562 and TSL2563 ambient light sensors.

	 This driver can also be built as a module.  If so, the module
	 will be called tsl2563.

config SENSORS_TSL258x
	tristate "TAOS TSL258x device driver"
	depends on I2C
	help
	  Provides support for the TAOS tsl258x family of devices.
	  Access ALS data via iio sysfs attributes.

	  This driver can also be built as a module.  If so, the module
	  will be called tsl258x.
```

## drivers/staging/stm-lis33/Kconfig
```kconfig
config STM_LIS33
	tristate "STMicroelectronics LIS331DLH accelerometer sensor"
	depends on I2C
	default n
```

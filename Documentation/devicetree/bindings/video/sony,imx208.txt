## Documentation/devicetree/bindings/video/sony,imx208.txt
```
Sony Camera sensor imx208 driver interface

Required properties:
- compatible: Value should be "sony,imx208"
- reg: Should contain I2C slave address of the driver.
- vana-supply: Analog power supply 2.8v
- vdig-supply: Digital power supply 1.2v
- vif-supply: Digital IO power supply 1.8v
- clocks: 24MHz mclk for sensor
- cam2-gpios: Senor reset pin

Example:
	imx208@37 {
		compatible = "sony,imx208";
		reg = <0x37>;
		vana-supply = <&pp2800l_rcam>;
		vdig-supply = <&pp1200_rcam>;
		vif-supply = <&pp1800_cam>;
		clocks = <&tegra_car TEGRA210_CLK_CLK_OUT_3>;
		clock-names = "clk_out_3";
		cam2-gpios = <&gpio FCAM_RSTN GPIO_ACTIVE_HIGH>;
	};
```

## Documentation/devicetree/bindings/video/sony,imx219.txt
```
Sony Camera sensor imx219 driver interface

Required properties:
- compatible: Value should be "sony,imx219"
- reg: Should contain I2C slave address of the driver.
- vana-supply: Analog power supply 2.8v
- vdig-supply: Digital power supply 1.2v
- dovdd-supply: Digital IO power supply 1.8v
- vdd_af1-supply: Analog power supply 2.8v for Focuser
- clocks: 24MHz mclk for sensor
- af-gpios: Reset pin for focuser
- reset-gpios: Senor reset pin

Example:

&vii2c {
	imx219@10 {
		compatible = "sony,imx219";
		reg = <0x10>;
		vana-supply = <&pp2800l_rcam>;
		vdig-supply = <&pp1200_rcam>;
		dovdd-supply = <&pp1800_cam>;
		vdd_af1-supply = <&pp2800l_fcam>;
		clocks = <&tegra_car TEGRA210_CLK_CLK_OUT_3>;
		clock-names = "clk_out_3";
		af-gpios = <&gpio CAM_AF_PWDN GPIO_ACTIVE_HIGH>;
		reset-gpios = <&gpio RCAM_RSTN GPIO_ACTIVE_HIGH>;
	};
```

## arch/arm/configs/mvebu_v7_cyclone_defconfig
```kconfig
CONFIG_SYSVIPC=y
CONFIG_FHANDLE=y
CONFIG_IRQ_DOMAIN_DEBUG=y
CONFIG_HIGH_RES_TIMERS=y
CONFIG_LOG_BUF_SHIFT=14
CONFIG_BLK_DEV_INITRD=y
CONFIG_EXPERT=y
CONFIG_SLAB=y
CONFIG_MODULES=y
CONFIG_MODULE_UNLOAD=y
CONFIG_ARCH_MVEBU=y
CONFIG_MACH_ARMADA_370=y
CONFIG_MACH_ARMADA_375=y
CONFIG_MACH_ARMADA_38X=y
CONFIG_MACH_ARMADA_XP=y
CONFIG_MACH_DOVE=y
CONFIG_PCI=y
CONFIG_PCI_MSI=y
CONFIG_PCI_MVEBU=y
CONFIG_SMP=y
CONFIG_AEABI=y
CONFIG_HIGHMEM=y
# CONFIG_COMPACTION is not set
CONFIG_ZBOOT_ROM_TEXT=0x0
CONFIG_ZBOOT_ROM_BSS=0x0
CONFIG_ARM_APPENDED_DTB=y
CONFIG_ARM_ATAG_DTB_COMPAT=y
CONFIG_CPU_FREQ=y
CONFIG_CPUFREQ_DT=y
CONFIG_CPU_IDLE=y
CONFIG_ARM_MVEBU_V7_CPUIDLE=y
CONFIG_VFP=y
CONFIG_NEON=y
CONFIG_NET=y
CONFIG_PACKET=y
CONFIG_UNIX=y
CONFIG_INET=y
CONFIG_IP_PNP=y
CONFIG_IP_PNP_DHCP=y
CONFIG_IP_PNP_BOOTP=y
CONFIG_IPV6=y
CONFIG_INET6_AH=m
CONFIG_INET6_ESP=m
CONFIG_INET6_XFRM_MODE_TRANSPORT=m
CONFIG_INET6_XFRM_MODE_TUNNEL=m
CONFIG_INET6_XFRM_MODE_BEET=m
CONFIG_IPV6_SIT=m
CONFIG_IPV6_NDISC_NODETYPE=y
CONFIG_IPV6_MULTIPLE_TABLES=y
CONFIG_IPV6_MROUTE=y
CONFIG_BT=y
CONFIG_BT_MRVL=y
CONFIG_BT_MRVL_SDIO=y
CONFIG_CFG80211=y
CONFIG_UEVENT_HELPER_PATH="/sbin/hotplug"
CONFIG_DEVTMPFS=y
CONFIG_DEVTMPFS_MOUNT=y
CONFIG_MTD=y
CONFIG_MTD_BLOCK=y
CONFIG_MTD_CFI=y
CONFIG_MTD_CFI_INTELEXT=y
CONFIG_MTD_CFI_AMDSTD=y
CONFIG_MTD_CFI_STAA=y
CONFIG_MTD_PHYSMAP_OF=y
CONFIG_MTD_M25P80=y
CONFIG_MTD_NAND=y
CONFIG_MTD_NAND_PXA3xx=y
CONFIG_MTD_SPI_NOR=y
CONFIG_BLK_DEV_SD=y
CONFIG_ATA=y
CONFIG_AHCI_MVEBU=y
CONFIG_SATA_MV=y
CONFIG_NETDEVICES=y
CONFIG_MV643XX_ETH=y
CONFIG_MVNETA=y
CONFIG_MVPP2=y
CONFIG_MARVELL_PHY=y
# CONFIG_MWIFIEX is not set
CONFIG_MWLWIFI=m
CONFIG_INPUT_EVDEV=y
CONFIG_KEYBOARD_GPIO=y
CONFIG_SERIAL_8250=y
CONFIG_SERIAL_8250_CONSOLE=y
CONFIG_SERIAL_8250_DW=y
CONFIG_SERIAL_OF_PLATFORM=y
CONFIG_I2C=y
CONFIG_I2C_MV64XXX=y
CONFIG_SPI=y
CONFIG_SPI_DEBUG=y
CONFIG_SPI_MASTER=y
CONFIG_SPI_ORION=y
CONFIG_SPI_SPIDEV=y
CONFIG_GPIO_SYSFS=y
CONFIG_SENSORS_GPIO_FAN=y
CONFIG_THERMAL=y
CONFIG_ARMADA_THERMAL=y
CONFIG_WATCHDOG=y
CONFIG_ORION_WATCHDOG=y
#CONFIG_SOUND is not set
CONFIG_USB=y
CONFIG_USB_XHCI_HCD=y
CONFIG_USB_XHCI_MVEBU=y
CONFIG_USB_EHCI_HCD=y
CONFIG_USB_EHCI_ROOT_HUB_TT=y
CONFIG_USB_STORAGE=y
CONFIG_MMC=y
CONFIG_MMC_SDHCI=y
CONFIG_MMC_SDHCI_PLTFM=y
CONFIG_MMC_SDHCI_DOVE=y
CONFIG_MMC_MVSDIO=y

CONFIG_RTC_CLASS=y
CONFIG_RTC_DRV_S35390A=y
CONFIG_RTC_DRV_MV=y
CONFIG_RTC_DRV_ARMADA38X=y
CONFIG_DMADEVICES=y
CONFIG_MV_XOR=y
CONFIG_ASYNC_TX_DMA=y
# CONFIG_IOMMU_SUPPORT is not set
CONFIG_MEMORY=y
CONFIG_EXT2_FS=y
CONFIG_EXT3_FS=y
CONFIG_EXT4_FS=y
CONFIG_ISO9660_FS=y
CONFIG_JOLIET=y
CONFIG_UDF_FS=m
CONFIG_MSDOS_FS=y
CONFIG_VFAT_FS=y
CONFIG_TMPFS=y
CONFIG_NFS_FS=y
CONFIG_ROOT_NFS=y
CONFIG_NLS_CODEPAGE_437=y
CONFIG_NLS_CODEPAGE_850=y
CONFIG_NLS_ISO8859_1=y
CONFIG_NLS_ISO8859_2=y
CONFIG_NLS_UTF8=y
CONFIG_PRINTK_TIME=y
CONFIG_DEBUG_INFO=y
CONFIG_DEBUG_FS=y
CONFIG_MAGIC_SYSRQ=y
# CONFIG_SCHED_DEBUG is not set
CONFIG_TIMER_STATS=y
# CONFIG_DEBUG_BUGVERBOSE is not set
CONFIG_DEBUG_USER=y
CONFIG_NF_NAT=y
CONFIG_NF_NAT_NEEDED=y

CONFIG_NETFILTER_XTABLES=y
CONFIG_NETFILTER_XT_MARK=m
CONFIG_NETFILTER_XT_MARK=m
CONFIG_NETFILTER_XT_TARGET_CLASSIFY=y
CONFIG_NETFILTER_XT_TARGET_DSCP=y
CONFIG_NETFILTER_XT_TARGET_LED=y
CONFIG_NETFILTER_XT_TARGET_NFLOG=y
CONFIG_NETFILTER_XT_TARGET_NFQUEUE=y
CONFIG_NETFILTER_XT_TARGET_SECMARK=y
CONFIG_NETFILTER_XT_TARGET_TCPMSS=m

CONFIG_NETFILTER_XT_MATCH_CONNTRACK=y
CONFIG_NETFILTER_XT_MATCH_DSCP=y
CONFIG_NETFILTER_XT_MATCH_OWNER=y
CONFIG_NETFILTER_XT_MATCH_POLICY=y
CONFIG_NETFILTER_XT_MATCH_STATE=y

CONFIG_STP=m
CONFIG_BRIDGE=m
CONFIG_BRIDGE_IGMP_SNOOPING=y
CONFIG_VLAN_8021Q=m
CONFIG_LLC=m

CONFIG_WIRELESS_EXT=y
CONFIG_WEXT_CORE=y
CONFIG_WEXT_PROC=y
CONFIG_WEXT_SPY=y
CONFIG_WEXT_PRIV=y
CONFIG_CFG80211_WEXT=y
CONFIG_LIB80211=y
CONFIG_LIB80211_CRYPT_WEP=y
CONFIG_LIB80211_CRYPT_CCMP=y
CONFIG_LIB80211_CRYPT_TKIP=y
CONFIG_MAC80211=y
CONFIG_MAC80211_HAS_RC=y
CONFIG_MAC80211_RC_MINSTREL=y
CONFIG_MAC80211_RC_MINSTREL_HT=y
CONFIG_MAC80211_RC_DEFAULT_MINSTREL=y
CONFIG_MAC80211_RC_DEFAULT="minstrel_ht"
CONFIG_CRYPTO_MICHAEL_MIC=y
CONFIG_USB_USBNET=m
CONFIG_USB_NET_CDCETHER=m
```

## arch/arm/mach-tegra/Kconfig
```kconfig
if ARCH_TEGRA

comment "NVIDIA Tegra options"

choice
	prompt "Select Tegra processor family for target system"

config ARCH_TEGRA_1x_SOC
	bool "Tegra APX 2x00 and Tegra 6x0 family"
	select CPU_V6
	help
	  Support for NVIDIA Tegra AP15 and AP16 processors, based on the
	  ARM11 MPCore CPU and a proprietary L2 cache controller


config ARCH_TEGRA_2x_SOC
	bool "Tegra 2 family"
	select CPU_V7
	select ARM_GIC
	select ARCH_REQUIRE_GPIOLIB
	help
	  Support for NVIDIA Tegra AP20 and T20 processors, based on the
	  ARM CortexA9MP CPU and the ARM PL310 L2 cache controller

endchoice

choice
	prompt "Select Tegra-based target product"

config MACH_TEGRA_GENERIC
	bool "Tegra development system board(s)"
	depends on (ARCH_TEGRA_1x_SOC || ARCH_TEGRA_2x_SOC)
	help
	  Support generic Tegra ODM-kit based development systems, including
	  the Whistler and Harmony T20 development systems

endchoice

config TEGRA_SYSTEM_DMA
	bool "Enable system DMA driver for NVIDIA Tegra SoCs"
	default y
	help
	  Adds system DMA functionality for NVIDIA Tegra SoCs, used by
	  several Tegra device drivers

config TEGRA_IOVMM_GART
	bool "Enable I/O virtual memory manager for GART"
	depends on ARCH_TEGRA_1x_SOC || ARCH_TEGRA_2x_SOC
	default y
	select TEGRA_IOVMM
	help
	  Enables support for remapping discontiguous physical memory
	  shared with the operating system into contiguous I/O virtual
	  space through the GART hardware included on Tegra and
	  Tegra 2 SoCs

config TEGRA_IOVMM
	bool

config MACH_TEGRA_GENERIC_DEBUG
	bool "Enable debug logging for Tegra generic drivers"
	depends on MACH_TEGRA_GENERIC
	help
	  Enables debug logging for the generic Tegra NvRm and NvOs drivers

config TEGRA_ODM_RFKILL
	bool "RF kill driver using NVIDIA Tegra ODM kit"
	depends on MACH_TEGRA_GENERIC && RFKILL
	help
	  Adds support for rfkill for systems using NVIDIA's Tegra ODM kit

config TEGRA_NVEC
	bool "Include driver for Tegra NvEC embedded controller interface"
	depends on MACH_TEGRA_GENERIC
	help
	  Adds support for the NVIDIA Tegra NvEC I2C-slave based protocol
	  for communicating to embedded controllers.

config TEGRA_NVEC_USER
	bool "Enable user-land access to NvEc-based embedded controller"
	depends on TEGRA_NVEC
	help
	  Enabling this option will expose a device node to enable user-land
	  clients to access embedded controller features.

config TEGRA_ODM_VIBRATE
	boolean "System vibrator device driver using NVIDIA Tegra ODM kit"
	depends on ANDROID_TIMED_OUTPUT && MACH_TEGRA_GENERIC
	default n
	help
	  Adds a timed output vibrator device node for an NVIDIA Tegra ODM kit
	  vibrator driver

config TEGRA_PCI
	boolean "PCIe host controller driver"
	depends on !ARCH_TEGRA_1x_SOC
	select PCI
	default n
	help
		Adds PCIe Host controller driver for tegra2 based systems

config TEGRA_SNOR
	boolean

source "arch/arm/mach-tegra/odm_kit/Kconfig"

endif
```

## arch/arm/mach-tegra/odm_kit/Kconfig
```kconfig
if MACH_TEGRA_GENERIC

choice
	prompt "Select ODM kit target board"

config TEGRA_ODM_HARMONY
	bool "NVIDIA Harmony development system"
	depends on ARCH_TEGRA_2x_SOC

config TEGRA_ODM_WHISTLER
	bool "NVIDIA Whistler development system"
	depends on ARCH_TEGRA_2x_SOC

config TEGRA_ODM_CONCORDE
	bool "NVIDIA Concorde development system"
	depends on ARCH_TEGRA_1x_SOC

endchoice

config TEGRA_PMU_TPS6586X_LD05_VOLTAGE
	int "Voltage for the TPS6586x LD05 power rail"
	depends on TEGRA_ODM_HARMONY
	default "2850"

endif
```

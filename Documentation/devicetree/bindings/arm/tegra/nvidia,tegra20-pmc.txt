## Documentation/devicetree/bindings/panel/jdi,lpm102a188a.txt
```
JDI LPM102A188A panel

Required properties for master panel:
- power-supply: regulator controlling avdd(vdd_30) line into the panel
- ddi-supply: regulator controlling vddi(vdd_18) line into the panel
- enable-gpio: gpio controlling the power_en line into the panel
- reset-gpio: gpio controlling the rstx(resx) line into the panel

Required properties for slave panel:
- master: phandle pointing to the master panel

Optional properties:
- backlight: phandle pointing to the i2c node representing the attached lp8557
	     backlight controller
- panel-boot-on: Denotes whether firmware has initialized the panel

Example:
	panel: panel@0 {
		compatible = "jdi,lpm102a188a";

		reg = <0 0>;

		power-supply = <&pplcd_vdd>;
		ddi-supply = <&pp1800_lcdio>;

		enable-gpio = <&gpio TEGRA_GPIO(H, 5) GPIO_ACTIVE_HIGH>;
		reset-gpio = <&gpio TEGRA_GPIO(H, 3) GPIO_ACTIVE_LOW>;

		backlight = <&backlight>;
		panel-boot-on;
	};
```

## Documentation/devicetree/bindings/pinctrl/nvidia,tegra124-xusb-padctl.txt
```
Device tree binding for NVIDIA Tegra XUSB pad controller
========================================================

The Tegra XUSB pad controller manages a set of lanes, each of which can be
assigned to one out of a set of different pads. Some of these pads have an
associated PHY that must be powered up before the pad can be used.

This document defines the device-specific binding for the XUSB pad controller.

Refer to pinctrl-bindings.txt in this directory for generic information about
pin controller device tree bindings and ../phy/phy-bindings.txt for details on
how to describe and reference PHYs in device trees.

Required properties:
--------------------
- compatible: should be "nvidia,tegra124-xusb-padctl"
- reg: Physical base address and length of the controller's registers.
- resets: Must contain an entry for each entry in reset-names.
  See ../reset/reset.txt for details.
- reset-names: Must include the following entries:
  - padctl
- #phy-cells: Should be 1. The specifier is the index of the PHY to reference.
  See <dt-bindings/pinctrl/pinctrl-tegra-xusb.h> for the list of valid values.
- mboxes: Must contain an entry for the XUSB mailbox channel.
  See ../mailbox/mailbox.txt for details.
- mbox-names: Must include the following entries:
  - xusb

Optional properties:
--------------------
- vddio-hsic-supply: VDDIO regulator for the HSIC pads.

PHY nodes:
----------

An optional child node named "phys" can contain nodes describing additional
properties of each PHY. Only USB3 and UTMI PHYs can be complemented in this
way, in which case the name of each node must match one of the following:

  usb3-0, usb3-1, utmi-0, utmi-1, utmi-2

Required properties for USB3 PHYs:
- nvidia,lanes: specifies the name of the lane that this USB3 PHY uses
- nvidia,port: specifies the number of the USB2 port that is used for this
  USB3 PHY

Optional properties for UTMI PHYs:
- vbus-supply: regulator providing the VBUS voltage for the UTMI pad

Lane muxing:
------------

Child nodes contain the pinmux configurations following the conventions from
the pinctrl-bindings.txt document. Typically a single, static configuration is
given and applied at boot time.

Each subnode describes groups of lanes along with parameters and pads that
they should be assigned to. The name of these subnodes is not important. All
subnodes should be parsed solely based on their content.

Each subnode only applies the parameters that are explicitly listed. In other
words, if a subnode that lists a function but no pin configuration parameters
implies no information about any pin configuration parameters. Similarly, a
subnode that describes only an IDDQ parameter implies no information about
what function the pins are assigned to. For this reason even seemingly boolean
values are actually tristates in this binding: unspecified, off or on.
Unspecified is represented as an absent property, and off/on are represented
as integer values 0 and 1.

Required properties:
- nvidia,lanes: An array of strings. Each string is the name of a lane.

Optional properties:
- nvidia,function: A string that is the name of the function (pad) that the
  pin or group should be assigned to. Valid values for function names are
  listed below.
- nvidia,iddq: Enables IDDQ mode of the lane. (0: no, 1: yes)
- nvidia,hsic-strobe-trim: HSIC strobe trimmer value.
- nvidia,hsic-rx-strobe-trim: HSIC RX strobe trimmer value. (0 - 7)
- nvidia,hsic-rx-data-trim: HSIC RX data trimmer value. (0 - 7)
- nvidia,hsic-tx-rtune-n: HSIC TX RTUNEN value. (0 - 7)
- nvidia,hsic-tx-rtune-p: HSIC TX RTUNEP value. (0 - 7)
- nvidia,hsic-tx-slew-n: HSIC TX SLEWN value. (0 - 7)
- nvidia,hsic-tx-slew-p: HSIC TX SLEWP value. (0 - 7)
- nvidia,hsic-auto-term: Enables HSIC AUTO_TERM. (0: no, 1: yes)
- nvidia,otg-hs-curr-level-offset: Offset to be applied to the pad's fused
  HS_CURR_LEVEL value. (0 - 63)

Note that not all of these properties are valid for all lanes. Lanes can be
divided into four groups:

  - otg-0, otg-1, otg-2:

    Valid functions for this group are: "snps", "xusb", "uart", "rsvd".

    Only the nvidia,otg-hs-curr-level-offset property applies.

  - ulpi-0:

    Valid functions for this group are: "snps", "xusb".

  - hsic-0, hsic-1:

    Valid functions for this group are: "snps", "xusb".

    Only the nvidia,hsic-* properties apply, and only when the function is
    xusb.

  - pcie-0, pcie-1, pcie-2, pcie-3, pcie-4, sata-0:

    Valid functions for this group are: "pcie", "usb3", "sata", "rsvd".

    Only the nvidia,iddq property applies.

Example:
========

SoC file extract:
-----------------

	padctl@0,7009f000 {
		compatible = "nvidia,tegra124-xusb-padctl";
		reg = <0x0 0x7009f000 0x0 0x1000>;
		resets = <&tegra_car 142>;
		reset-names = "padctl";
		mboxes = <&xusb_mbox>;
		mbox-names = "xusb";

		#phy-cells = <1>;
	};

Board file extract:
-------------------

	pcie-controller@0,01003000 {
		...

		phys = <&padctl 0>;
		phy-names = "pcie";

		...
	};

	...

	usb@0,70090000 {
		...

		phys = <&padctl 5>, <&padctl 6>, <&padctl 7>;
		phy-names = "utmi-1", "utmi-2", "usb3-0";

		...
	}

	...

	padctl: padctl@0,7009f000 {
		pinctrl-0 = <&padctl_default>;
		pinctrl-names = "default";

		phys {
			usb3-0 {
				status = "okay";

				nvidia,lanes = "pcie-0";
				nvidia,port = <2>;
			};

			utmi-1 {
				status = "okay";
			};

			utmi-2 {
				status = "okay";

				vbus-supply = <&vdd_usb3_vbus>;
			};
		};

		padctl_default: pinmux {
			otg {
				nvidia,lanes = "otg-1", "otg-2";
				nvidia,function = "xusb";
			};

			usb3p0 {
				nvidia,lanes = "pcie-0";
				nvidia,function = "usb3";
				nvidia,iddq = <0>;
			};

			pcie {
				nvidia,lanes = "pcie-2", "pcie-3",
					       "pcie-4";
				nvidia,function = "pcie";
				nvidia,iddq = <0>;
			};

			sata {
				nvidia,lanes = "sata-0";
				nvidia,function = "sata";
				nvidia,iddq = <0>;
			};
		};
	};
```

## Documentation/devicetree/bindings/regulator/max8973-regulator.txt
```
* Maxim MAX8973 and MAX77621 Voltage Regulators

Required properties:

- compatible:	must be "maxim,max8973" or "maxim,max77621"
- reg:		the i2c slave address of the regulator. It should be 0x1b for
		max8973.  It may be 0x1b or 0x1c for max77621.

Any standard regulator properties can be used to configure the single max8973
or max77621 DCDC.

Optional properties:

-maxim,externally-enable: boolean, externally control the regulator output
		enable/disable.  Otherwise, enable/disable via I2C registers.
-maxim,dvs-gpios: GPIO which is connected to DVS pin of device.
-maxim,dvs-default-state: Default state of GPIO during initialisation.
		1 for HIGH and 0 for LOW.
-maxim,enable-remote-sense: boolean, enable remote sense.
-maxim,enable-falling-slew-rate: boolean, enable falling slew rate.
-maxim,enable-active-discharge: boolean: enable active discharge.
-maxim,enable-frequency-shift: boolean, enable 9% frequency shift.
-maxim,enable-bias-control: boolean, enable bias control. By enabling this
		startup delay can be reduce to 20us from 220us.

Example:

	max8973@1b {
		compatible = "maxim,max8973";
		reg = <0x1b>;

		regulator-min-microvolt = <935000>;
		regulator-max-microvolt = <1200000>;
		regulator-boot-on;
		regulator-always-on;
	};
```

## Documentation/devicetree/bindings/sound/nau8825.txt
```
Nuvoton NAU8825 audio codec

This device supports I2C only.

Required properties:
  - compatible : Must be "nuvoton,nau8825"

  - reg : the I2C address of the device. This is either 0x1a (CSB=0) or 0x1b (CSB=1).

Optional properties:
  - nuvoton,jkdet-enable: Enable jack detection via JKDET pin.
  - nuvoton,jkdet-pull-enable: Enable JKDET pin pull. If set - pin pull enabled,
      otherwise pin in high impedance state.
  - nuvoton,jkdet-pull-up: Pull-up JKDET pin. If set then JKDET pin is pull up, otherwise pull down.
  - nuvoton,jkdet-polarity: JKDET pin polarity. 0 - active high, 1 - active low.

  - nuvoton,vref-impedance: VREF Impedance selection
      0 - Open
      1 - 25 kOhm
      2 - 125 kOhm
      3 - 2.5 kOhm

  - nuvoton,micbias-voltage: Micbias voltage level.
      0 - VDDA
      1 - VDDA
      2 - VDDA * 1.1
      3 - VDDA * 1.2
      4 - VDDA * 1.3
      5 - VDDA * 1.4
      6 - VDDA * 1.53
      7 - VDDA * 1.53

  - nuvoton,sar-threshold-num: Number of buttons supported
  - nuvoton,sar-threshold: Impedance threshold for each button. Array that contains up to 8 buttons configuration. SAR value is calculated as
    SAR = 255 * MICBIAS / SAR_VOLTAGE * R / (2000 + R)
    where MICBIAS is configured by 'nuvoton,micbias-voltage', SAR_VOLTAGE is configured by 'nuvoton,sar-voltage', R - button impedance.
    Refer datasheet section 10.2 for more information about threshold calculation.

  - nuvoton,sar-hysteresis: Button impedance measurement hysteresis.

  - nuvoton,sar-voltage: Reference voltage for button impedance measurement.
      0 - VDDA
      1 - VDDA
      2 - VDDA * 1.1
      3 - VDDA * 1.2
      4 - VDDA * 1.3
      5 - VDDA * 1.4
      6 - VDDA * 1.53
      7 - VDDA * 1.53

  - nuvoton,short-key-debounce: Button short key press debounce time.
      0 - 30ms
      1 - 50ms
      2 - 100ms
      3 - 30ms

  - nuvoton,jack-insert-debounce: number from 0 to 7 that sets debounce time to 2^(n+2) ms
  - nuvoton,jack-eject-debounce: number from 0 to 7 that sets debounce time to 2^(n+2) ms


Example:

  headset: nau8825@1a {
      compatible = "nuvoton,nau8825";
      reg = <0x1a>;
      interrupt-parent = <&gpio>;
      interrupts = <TEGRA_GPIO(E, 6) IRQ_TYPE_LEVEL_LOW>;
      nuvoton,jkdet-enable;
      nuvoton,jkdet-pull-enable;
      nuvoton,jkdet-pull-up;
      nuvoton,jkdet-polarity = <GPIO_ACTIVE_LOW>;
      nuvoton,vref-impedance = <2>;
      nuvoton,micbias-voltage = <6>;
      // Setup 4 buttons impedane according to Android specification
      nuvoton,sar-threshold-num = <4>;
      nuvoton,sar-threshold = <0xc 0x1e 0x38 0x60>;
      nuvoton,sar-hysteresis = <1>;
      nuvoton,sar-voltage = <0>;
      nuvoton,short-key-debounce = <2>;
      nuvoton,jack-insert-debounce = <7>;
      nuvoton,jack-eject-debounce = <7>;
  };
```

## Documentation/devicetree/bindings/sound/rt5677-spi.txt
```
RT5677 audio CODEC SPI interface

This device supports the SPI interface on the 5677 that is used to communicate
with the on-chip DSP.

Required properties:

- compatible : "realtek,rt5677-spi" or "realtek,rt5676-spi".

- reg : Chip select line if applicable or <0>.

Example:

&spi1 {
	status = "okay";
	codec@0 {
		compatible = "realtek,rt5677-spi";
		reg = <0>;
		spi-max-frequency = <24000000>;
	};
};
```

## Documentation/devicetree/bindings/thermal/tegra-dram-therm.txt
```
DRAM thermal driver.

Required properties:
 - compatible : "nvidia,tegra-dram-therm".
 - #thermal-sensor-cell : should be 0.
 - #cooling-cells : should be 2.

Example:
	dram_therm: dram_therm {
		compatible = "nvidia,tegra-dram-therm";
		#thermal-sensor-cells = <0>;
		#cooling-cells = <2>;
	};
```

## Documentation/devicetree/bindings/thermal/tegra-thermal-action.txt
```
* Tegra thermal reaction node
* This device can act as cooling device in of-thermal framework, and can set
* trips and cooling-maps node in the thermal-zones node.
----------------------------------------------------

Tegra DFLL cdev action device.
** Required properties:
- compatible : "nvidia,tegra-dfll-cdev-action".
- act-dev: Node of the device which will implement the real cooling action.
- cdev-type: Name of the cooling device. Valid values are "DFLL-floor" and
             "DFLL-cap".

Note: for the trips, the corresponding temperatures are defined in the
include/dt-bindings/thermal/tegra132-dfll-trips.h.

Tegra CPU-EDP cdev action device.
** Required properties:
- compatible : "nvidia,tegra124-cpu-edp-cdev-action".
- act-dev: Node of the device which will implement the real cooling action.
- cdev-type: Name of the cooling device. Valid value is "CPU-EDP-cap".

Tegra CORE DVFS cdev action device.
** Required properties:
- compatible : "nvidia,tegra-core-cdev-action".
- cdev-type: Name of the cooling device. Valid value is "CORE-floor" and
             "CORE-cap".

Example node:

dfll_floor: dfll_cdev_floor {
	compatible = "nvidia,tegra-dfll-cdev-action";
	act-dev = <&{/dfll@70110000}>;
	cdev-type = "DFLL-floor";
};

cpu_edp_cap: cpu_edp_cdev_cap {
	compatible = "nvidia,tegra124-cpu-edp-cdev-action";
	act-dev = <&cpu_edp>;
	cdev-type = "CPU-EDP-cap";
	#cooling-cells = <2>; /* min followed by max */
};

core_dvfs_floor: core_dvfs_cdev_floor {
	compatible = "nvidia,tegra-core-cdev-action";
	cdev-type = "CORE-floor";
	#cooling-cells = <2>; /* min followed by max */
};

thermal-zones {
	cpu {
		trips {
			dfll_floor_trip0: dfll_floor_trip0 {
				temperature = <TEGRA132_DFLL_THERMAL_FLOOR_0>; /* millicelsius */
				hysteresis = <1000>; /* millicelsius */
				type = "active";
			};
			cpu_edp_cap_trip0: cpu_edp_cap_trip0 {
				temperature = <18000>; /* millicelsius */
				hysteresis = <1000>;
				type = "active";
			};
			core_dvfs_floor_trip0: core_dvfs_floor_trip0 {
				temperature = <15000>; /* millicelsius */
				hysteresis = <1000>;
				type = "active";
			};
		};
		cooling-maps {
			map0 {
				trip = <&dfll_floor_trip0>;
				cooling-device = <&dfll_floor 1 1>;
			};
			map1 {
				trip = <&cpu_edp_cap_trip0>;
				cooling-device = <&cpu_edp_cap 1 1>;
			};
			map2 {
				trip = <&core_dvfs_floor_trip0>;
				cooling-device = <&core_dvfs_floor 1 1>;
			};
		};
	};
};
```

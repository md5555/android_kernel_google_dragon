## Documentation/devicetree/bindings/mailbox/nvidia,tegra210-bpmp-mbox.txt
```
NVIDIA Tegra BPMP mailbox
=========================

The Tegra BPMP mailbox is used by the Tegra BPMP firmware for request
communication between the host and BPMP.

Refer to ./mailbox.txt for generic information about mailbox device-tree
bindings.

* BPMP Mailbox Controller

Required properties:
--------------------
 - compatible: Should be "nvidia,tegra210-bpmp-mbox".
 - reg: Should contain two entries:
   - Address and length of Semaphores registers.
   - Address and length of Atomics registers.
 - reg-names: Must include the followings:
   - sema
   - atomics
 - interrupts: BPMP-lite mailbox interrupts. Must contain 5 entries:
   - First four entries: interrupts from COP to CPU
   - The last entry: the interrupt from CPU to COP
 - #mbox-cells: Should be 1.

Example:
--------
	bpmp_mbox: mailbox@60001000 {
		compatible = "nvidia,tegra210-bpmp-mbox";
		reg = <0x0 0x60001000 0x0 0x1000>,
		      <0x0 0x70016000 0x0 0x1000>;
		reg-names = "sema", "atomics";
		interrupts = <GIC_SPI 4 IRQ_TYPE_LEVEL_HIGH>,
			     <GIC_SPI 5 IRQ_TYPE_LEVEL_HIGH>,
			     <GIC_SPI 7 IRQ_TYPE_LEVEL_HIGH>,
			     <GIC_SPI 18 IRQ_TYPE_LEVEL_HIGH>,
			     <GIC_SPI 6 IRQ_TYPE_LEVEL_HIGH>;

		#mbox-cells = <1>;
	};

* BPMP Mailman

Acting as mailbox clients, mailman makes use of mailbox channels and
exports interfaces to its users.

Required properties:
--------------------
 - compatible: Should be "nvidia,tegra210-bpmp-mailman".
 - reg: Address and length of COP reset vector address register.
 - reg-names: cop-reset-vec
 - mboxes: List of phandle and mailbox channel specifiers. For Tegra210,
	   should contain twelve channels as the example below.
 - resets: Must contain an entry for each entry in reset-names.
	   See ../reset/reset.txt for details.
 - reset-names: cop
 - nvidia,bpmp-mbox: the phandle of the BPMP mailbox device node

Example:
--------
	bpmp-mailman@6000f200 {
		compatible = "nvidia,tegra210-bpmp-mailman";
		reg = <0x0 0x6000f200 0x0 0x4>;
		reg-names = "cop-reset-vec";
		mboxes = <&bpmp_mbox 0		/* CPU 0 outbox channel */
			  &bpmp_mbox 1		/* CPU 1 outbox channel */
			  &bpmp_mbox 2		/* CPU 2 outbox channel */
			  &bpmp_mbox 3		/* CPU 3 outbox channel */
			  &bpmp_mbox 4		/* thread channel */
			  &bpmp_mbox 5		/* thread channel */
			  &bpmp_mbox 6		/* thread channel */
			  &bpmp_mbox 7		/* thread channel */
			  &bpmp_mbox 8		/* CPU 0 inbox channel */
			  &bpmp_mbox 9		/* CPU 1 inbox channel */
			  &bpmp_mbox 10		/* CPU 2 inbox channel */
			  &bpmp_mbox 11>;	/* CPU 3 inbox channel */

		resets = <&tegra_car TEGRA210_CLK_COP>;
		reset-names = "cop";
		nvidia,bpmp-mbox = <&bpmp_mbox>;
	};
```

## Documentation/devicetree/bindings/mfd/max77620.txt
```
* MAX77620 Power management IC.

Required properties:
-------------------
- compatible: Must be "maxim,max77620".
- reg: I2C device address.
- interrupt-controller: MAX77620 has internal interrupt controller which takes the
  interrupt request from internal sub-blocks like RTC, regulators, GPIOs as well
  as external input.
- #interrupt-cells: Should be set to 2 for IRQ number and flags.
  The first cell is the IRQ number. IRQ numbers for different interrupt source
  of MAX77620 are defined at dt-bindings/mfd/max77620.h
  The second cell is the flags, encoded as the trigger masks from binding document
	interrupts.txt, using dt-bindings/irq.

Optional properties:
-------------------

Optional submodules and their properties:
=======================================

Flexible power sequence configuration
====================================
The flexible power sequencer allows each regulator to power up under hardware or
software control.  This sub-node configures the FPS of the device. The device
has 3 FPS represented as FPS0, FPS1 and FPS2. The FPS sub-node name is "fps" and
their children each have a register property to represent the FPS number.

The properties for the fps child nodes:
Required properties:
	-reg: FPS numbers (i.e. 0, 1, 2 for FPS0, FPS1 and FPS2 respectively)
Optional properties:
	-maxim,fps-time-period: U32 for the FPS time period in uS.  Must be one
			of: 40, 80, 160, 320, 640, 1280, 2560, 5120
	-maxim,fps-enable-input: FPS enable source like EN0, EN1 or SW. The
			macros are defined on dt-bindings/mfd/max77620.h for
			different enable source.
				FPS_EN_SRC_EN0 for EN0 enable source.
				FPS_EN_SRC_EN1 for En1 enable source.
				FPS_EN_SRC_SW for SW based control.
	-maxim,fps-sw-enable: Boolean, applicable if maxim,fps-enable-input is
			set to FPS_EN_SRC_SW. If this property is present, then
			FPS is enabled.  Otherwise, the FPS is disabled.
	-maxim,enable-sleep: Enable sleep when the external control goes from
			HIGH to LOW.
	-maxim,enable-global-lpm: Enable global LPM when the external control goes from
			HIGH to LOW.

Pinmux and GPIO:
===============
The device has 8 GPIO pins which can be configured as GPIO as well as the
special IO functions and are programmable through the standard pinctrl/gpio
device tree representations (see pinctrl/pinctrl-bindings.txt and
gpio/gpio.txt)

For the pinmux configuration, the pins must be one of: gpio0, gpio1, gpio2,
gpio3, gpio4, gpio5, gpio6, gpio7

For each pin, the following optional properties specific to max77620 are
available:
	Optional properties:
		Valid values for function properties are:
			gpio, lpm-control-in, fps-out, 32k-out1,
			sd0-dvs-in, sd1-dvs-in, reference-out
		Theres is also customised property for the GPIO1,
			GPIO2 and GPIO3.
		- maxim,fps-source: FPS source for the gpios. Valid
			values are FPS_SRC_0, FPS_SRC_1, FPS_SRC_2
			and FPS_SRC_NONE.
			Absence of this property will leave the pin on
			default.
		- maxim,fps-power-up-period: Power up period/slot on
			given FPS. Valid values are 0 to 7.
		- maxim,fps-power-down-period: Power down period/slot
			on given FPS. Valid values are 0 to 7.

Regulators:
===========
Device has multiple DCDC(sd[0-3] and LDOs(ld[0-8]). The node "regulators" is
required if regulator functionality is needed.

The following are properties of the regulator sub-node:

    Optional properties:
    -------------------
	The input supply of regulators are the optional properties on the
	regulator node. The input supply of these regulators are provided
	through the following properties:
		in-sd0-supply: Input supply for SD0, INA-SD0 or INB-SD0 pins.
		in-sd1-supply: Input supply for SD1.
		in-sd2-supply: Input supply for SD2.
		in-sd3-supply: Input supply for SD3.
		in-ldo0-1-supply: Input supply for LDO0 and LDO1.
		in-ldo2-supply: Input supply for LDO2.
		in-ldo3-5-supply: Input supply for LDO3 and LDO5
		in-ldo4-6-supply: Input supply for LDO4 and LDO6.
		in-ldo7-8-supply: Input supply for LDO7 and LDO8.


    Optional sub-nodes for regulators:
    ---------------------------------
	The subnodes name is the name of regulator and it must be one of:
	sd[0-3], ldo[0-8]

	Each sub-node should contain the constraints and initialization
	information for that regulator. See regulator.txt for a description
	of standard properties for these sub-nodes.
	Additional optional custom properties  are listed below.
		maxim,fps-source: FPS source. The macros are defined at
				dt-bindings/mfd/max77620.h
		maxim,fps-power-up-period: Power up slot for rail on given FPS.
		maxim,fps-power-down-period: Power down slot for rail on given
				FPS.
		maxim,enable-group-low-power: Enable group low power mode.  When
			enabled, power mode will be controlled by the global
			low-power mode state.
		maxim,enable-sd0-en2-control: Enable EN2 pincontrol for SD0.
			This property is only applicable for SD0.  EN2 is an
			input pin that enable/disable SD0.
		maxim,disable-active-discharge: Boolean, disable active
			discharge.

Backup Battery:
==============
This sub-node configure charging backup battery of the device. Device has
support of charging the backup battery. The subnode name is "backup-battery".
The property for backup-battery child nodes as:
Presense of this child node will enable the backup battery charging.

Optional properties:
	-maxim,backup-battery-charging-current: Charging current setting.
			Device supports one of:  50/100/200/400/600/800 (uA)
			If this property is unavailable then it will
			charge with 50uA.
	-maxim,backup-battery-charging-voltage: Charging Voltage Limit Setting.
			Device supports one of:
				2500000/3000000/3300000/350000 (uV)
			Default will be set to 2500mV.
	-maxim,backup-battery-output-resistor: Output resistor on Ohm.
			Device supports one of: 100/1000/3000/6000 (Ohms)
Watchdog:
==============
This sub-node configure watchdog timer of the device. Device has watchdog
for monitoring system health. If WDT expire, system get reset.

Optional properties:
	-maxim,wdt-timeout: Watchdog timeout
		One of: 2, 16, 64, 128 (seconds)
	-maxim,wdt-clear-time: Watch dog clear time in seconds.  Should be less
		than timeout.
	-maxim,otp-wdtt: Boolean, OTP wdt.
	-maxim,otp-wdten: Boolean, OTP WDT enable.

	This node status can be disabled and if it is disabled then WDT will
be OFF on system.

32k Clock:
==============
The following optional property pertains to max77620's 32k clock:
	-maxim, enable-clock32k-out: enables max77620's 32k clock on boot

Power and Reset:
==============
The following optional properties pertains to max77620's power and reset
controls:
	- maxim,system-pmic-power-off: If present, PMIC controls system
		power off
	- maxim,system-pmic-power-reset: If present, PMIC controls system
		reset
	- maxim,system-power-controller: If present, PMIC controls system
		reset and power.  Same as setting maxim,system-pmic-power-off
		and maxim,sytstem-pmic-power-reset

Low-Battery:
==============
The following optional property pertains to max77620's Low-Battery threshold:
	-maxim,lb-threshold-vol: Low-Battery DAC falling threshold in mV. Must be one
			of: 2700, 2800, 2900, 3000, 3100, 3200, 3300, 3400. If not set,
			the default threshold is OTP setting.

Example:
--------
#include <dt-bindings/mfd/max77620.h>
...
max77620@3c {
	compatible = "maxim,max77620";
	reg = <0x3c>;

	interrupt-parent = <&intc>;
	interrupts = <0 86 IRQ_TYPE_NONE>;


Example:
--------
#include <dt-bindings/mfd/max77620.h>
...
max77620@3c {
	compatible = "maxim,max77620";
	reg = <0x3c>;

	interrupt-parent = <&intc>;
	interrupts = <0 86 IRQ_TYPE_NONE>;

	interrupt-controller;
	#interrupt-cells = <2>;

	gpio-controller;
	#gpio-cells = <2>;

	backup-battery {
		maxim,backup-battery-charging-current = <100>;
		maxim,backup-battery-charging-voltage = <3000000>;
		maxim,backup-battery-output-resister = <100>;
	};

	fps {
		#address-cells = <1>;
		#size-cells = <0>;
		fps@0 {
			reg = <0>;
			maxim,fps-time-period = <100>;
			maxim,fps-enable-input = <FPS_EN_SRC_EN0>;
		};

		fps@1 {
			reg = <1>;
			maxim,fps-time-period = <100>;
			maxim,fps-enable-input = <FPS_EN_SRC_EN1>;
		};

		fps@2 {
			reg = <2>;
			maxim,fps-time-period = <100>;
			maxim,fps-enable-input = <FPS_EN_SRC_SW>;
		};
	};

	watchdog {
		maxim,wdt-timeout = <16>;
		maxim,wdt-clear-time = <13>;
	};

	regulators {
		in-ldo0-1-supply = <&max77620_sd2>;
		in-ldo7-8-supply = <&max77620_sd2>;

		max77620_sd0: sd0 {
			regulator-name = "vdd-core";
			regulator-min-microvolt = <600000>;
			regulator-max-microvolt = <1400000>;
			regulator-boot-on;
			regulator-always-on;
			maxim,fps-source = <FPS_SRC_1>;
			regulator-init-mode = <REGULATOR_MODE_NORMAL>;
		};

		max77620_sd1: sd1 {
			regulator-name = "vddio-ddr";
			regulator-min-microvolt = <1200000>;
			regulator-max-microvolt = <1200000>;
			regulator-always-on;
			regulator-boot-on;
			regulator-init-mode = <REGULATOR_MODE_NORMAL>;
			maxim,fps-source = <FPS_SRC_0>;
		};

		max77620_sd2: sd2 {
			regulator-name = "vdd-pre-reg";
			regulator-min-microvolt = <1350000>;
			regulator-max-microvolt = <1350000>;
			maxim,fps-source = <FPS_SRC_1>;
		};

		max77620_sd3: sd3 {
			regulator-name = "vdd-1v8";
			regulator-min-microvolt = <1800000>;
			regulator-max-microvolt = <1800000>;
			regulator-always-on;
			regulator-boot-on;
			maxim,fps-source = <FPS_SRC_0>;
			regulator-init-mode = <REGULATOR_MODE_NORMAL>;
		};

		max77620_ldo0: ldo0 {
			regulator-name = "avdd-sys";
			regulator-min-microvolt = <1200000>;
			regulator-max-microvolt = <1200000>;
			regulator-always-on;
			regulator-boot-on;
			maxim,fps-source = <FPS_SRC_NONE>;
		};

		max77620_ldo1: ldo1 {
			regulator-name = "vdd-pex";
			regulator-min-microvolt = <1050000>;
			regulator-max-microvolt = <1050000>;
			maxim,fps-source = <FPS_SRC_NONE>;
		};

		max77620_ldo2: ldo2 {
			regulator-name = "vddio-sdmmc3";
			regulator-min-microvolt = <1800000>;
			regulator-max-microvolt = <3300000>;
			maxim,fps-source = <FPS_SRC_NONE>;
		};

		max77620_ldo3: ldo3 {
			regulator-name = "vdd-cam-hv";
			regulator-min-microvolt = <2800000>;
			regulator-max-microvolt = <2800000>;
			maxim,fps-source = <FPS_SRC_NONE>;
		};

		max77620_ldo4: ldo4 {
			regulator-name = "vdd-rtc";
			regulator-min-microvolt = <1250000>;
			regulator-max-microvolt = <1250000>;
			regulator-always-on;
			regulator-boot-on;
			maxim,fps-source = <FPS_SRC_0>;
		};

		max77620_ldo5: ldo5 {
			regulator-name = "avdd-ts-hv";
			regulator-min-microvolt = <3000000>;
			regulator-max-microvolt = <3000000>;
			maxim,fps-source = <FPS_SRC_NONE>;
		};

		max77620_ldo6: ldo6 {
			regulator-name = "vdd-ts";
			regulator-min-microvolt = <1800000>;
			regulator-max-microvolt = <1800000>;
			regulator-always-on;
			regulator-boot-on;
			maxim,fps-source = <FPS_SRC_NONE>;
		};

		max77620_ldo7: ldo7 {
			regulator-name = "vdd-gen-pll-edp";
			regulator-min-microvolt = <1050000>;
			regulator-max-microvolt = <1050000>;
			regulator-always-on;
			regulator-boot-on;
			maxim,fps-source = <FPS_SRC_1>;
		};

		max77620_ldo8: ldo8 {
			regulator-name = "vdd-hdmi-dp";
			regulator-min-microvolt = <1050000>;
			regulator-max-microvolt = <1050000>;
			maxim,fps-source = <FPS_SRC_NONE>;
		};
	};
};
```

## Documentation/devicetree/bindings/mfd/nvidia,tegra124-xusb.txt
```
NVIDIA Tegra XUSB host complex
==============================

The XUSB host complex on Tegra124 and later SoCs contains an xHCI host
controller and a mailbox for communication with the XUSB micro-controller.

Required properties:
--------------------
 - compatible: For Tegra124, must contain "nvidia,tegra124-xusb".
   Otherwise, must contain '"nvidia,<chip>-xusb", "nvidia,tegra124-xusb"'
   where <chip> is tegra132.
 - reg: Must contain the base and length of the XUSB FPCI registers.
 - ranges: Bus address mapping for the XUSB block.  Can be empty since the
   mapping is 1:1.
 - #address-cells: Must be 2.
 - #size-cells: Must be 2.

Example:
--------
	usb@0,70098000 {
		compatible = "nvidia,tegra124-xusb";
		reg = <0x0 0x70098000 0x0 0x1000>;
		ranges;

		#address-cells = <2>;
		#size-cells = <2>;

		usb-host@0,70090000 {
			compatible = "nvidia,tegra124-xhci";
			...
		};

		mailbox {
			compatible = "nvidia,tegra124-xusb-mbox";
			...
		};
	};
```

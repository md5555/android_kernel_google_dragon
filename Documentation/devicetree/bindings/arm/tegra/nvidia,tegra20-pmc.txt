## Documentation/devicetree/bindings/arm/tegra/nvidia,tegra20-pmc.txt
```
NVIDIA Tegra Power Management Controller (PMC)

The PMC block interacts with an external Power Management Unit. The PMC
mostly controls the entry and exit of the system from different sleep
modes. It provides power-gating controllers for SoC and CPU power-islands.

Required properties:
- name : Should be pmc
- compatible : Should contain "nvidia,tegra<chip>-pmc".
- reg : Offset and length of the register set for the device
- clocks : Must contain an entry for each entry in clock-names.
  See ../clocks/clock-bindings.txt for details.
- clock-names : Must include the following entries:
  "pclk" (The Tegra clock of that name),
  "clk32k_in" (The 32KHz clock input to Tegra).

Optional properties:
- nvidia,invert-interrupt : If present, inverts the PMU interrupt signal.
  The PMU is an external Power Management Unit, whose interrupt output
  signal is fed into the PMC. This signal is optionally inverted, and then
  fed into the ARM GIC. The PMC is not involved in the detection or
  handling of this interrupt signal, merely its inversion.
- nvidia,suspend-mode : The suspend mode that the platform should use.
  Valid values are 0, 1 and 2:
  0 (LP0): CPU + Core voltage off and DRAM in self-refresh
  1 (LP1): CPU voltage off and DRAM in self-refresh
  2 (LP2): CPU voltage off
- nvidia,core-power-req-active-high : Boolean, core power request active-high
- nvidia,sys-clock-req-active-high : Boolean, system clock request active-high
- nvidia,combined-power-req : Boolean, combined power request for CPU & Core
- nvidia,cpu-pwr-good-en : Boolean, CPU power good signal (from PMIC to PMC)
			   is enabled.
- nvidia,pmc-clk1-out-en : Boolean, keep the PMC clk1 output still avaiable
			   during suspend phase.
- nvidia,pmc-clk1-out-src : It should be the value below to indicate the clock
			    source.
			    PMC_CLK_OUT_SRC_OSC, PMC_CLK_OUT_SRC_OSC_DIV_2,
			    PMC_CLK_OUT_SRC_OSC_DIV_4

Required properties when nvidia,suspend-mode is specified:
- nvidia,cpu-pwr-good-time : CPU power good time in uS.
- nvidia,cpu-pwr-off-time : CPU power off time in uS.
- nvidia,core-pwr-good-time : <Oscillator-stable-time Power-stable-time>
			      Core power good time in uS.
- nvidia,core-pwr-off-time : Core power off time in uS.

Required properties when nvidia,suspend-mode=<0>:
- nvidia,lp0-vec : <start length> Starting address and length of LP0 vector
  The LP0 vector contains the warm boot code that is executed by AVP when
  resuming from the LP0 state. The AVP (Audio-Video Processor) is an ARM7
  processor and always being the first boot processor when chip is power on
  or resume from deep sleep mode. When the system is resumed from the deep
  sleep mode, the warm boot code will restore some PLLs, clocks and then
  bring up CPU0 for resuming the system.

Hardware-triggered thermal reset:
On Tegra30, Tegra114 and Tegra124, if the 'i2c-thermtrip' subnode exists,
hardware-triggered thermal reset will be enabled.

Required properties for hardware-triggered thermal reset (inside 'i2c-thermtrip'):
- nvidia,i2c-controller-id : ID of I2C controller to send poweroff command to. Valid values are
                             described in section 9.2.148 "APBDEV_PMC_SCRATCH53_0" of the
                             Tegra K1 Technical Reference Manual.
- nvidia,bus-addr : Bus address of the PMU on the I2C bus
- nvidia,reg-addr : I2C register address to write poweroff command to
- nvidia,reg-data : Poweroff command to write to PMU

Optional properties for hardware-triggered thermal reset (inside 'i2c-thermtrip'):
- nvidia,pinmux-id : Pinmux used by the hardware when issuing poweroff command.
                     Defaults to 0. Valid values are described in section 12.5.2
                     "Pinmux Support" of the Tegra4 Technical Reference Manual.

Example:

/ SoC dts including file
pmc@7000f400 {
	compatible = "nvidia,tegra20-pmc";
	reg = <0x7000e400 0x400>;
	clocks = <&tegra_car 110>, <&clk32k_in>;
	clock-names = "pclk", "clk32k_in";
	nvidia,invert-interrupt;
	nvidia,suspend-mode = <1>;
	nvidia,cpu-pwr-good-time = <2000>;
	nvidia,cpu-pwr-off-time = <100>;
	nvidia,core-pwr-good-time = <3845 3845>;
	nvidia,core-pwr-off-time = <458>;
	nvidia,core-power-req-active-high;
	nvidia,sys-clock-req-active-high;
	nvidia,lp0-vec = <0xbdffd000 0x2000>;
	nvidia,pmc-clk1-out-en;
	nvidia,pmc-clk1-out-src = <PMC_CLK_OUT_SRC_OSC_DIV_2>;
};

/ Tegra board dts file
{
	...
	pmc@7000f400 {
		i2c-thermtrip {
			nvidia,i2c-controller-id = <4>;
			nvidia,bus-addr = <0x40>;
			nvidia,reg-addr = <0x36>;
			nvidia,reg-data = <0x2>;
		};
	};
	...
	clocks {
		compatible = "simple-bus";
		#address-cells = <1>;
		#size-cells = <0>;

		clk32k_in: clock {
			compatible = "fixed-clock";
			reg=<0>;
			#clock-cells = <0>;
			clock-frequency = <32768>;
		};
	};
	...
};

Wake up events

The PMC is the only device that can wake up the system from deep sleep
mode (i.e. LP0). There are some wake up events in the PMC wake mask
register that can be used to trigger PMC to wake up the system. The PMC
wake mask register defines which devices or siganls can be the source to
trigger the PMC waking up. If the devices support waking up the system
from deep sleep mode, then it needs to describe a property for PMC wake
up events. This property defines the usage.

Required properties when nvidia,suspend-mode=<0>:
- nvidia,pmc-wakeup : <pmc_phandle event_type event_offset trigger_type>
		     pmc_phandle: the phandle of PMC device tree node
		     event_type: 0 = PMC_WAKE_TYPE_GPIO
				 1 = PMC_WAKE_TYPE_EVENT
		     event_offset: the offset of PMC wake mask register
		     trigger_type: set 0 when event_type is PMC_WAKE_TYPE_GPIO
				   if event_type is PMC_WAKE_TYPE_EVENT
				   0 = PMC_TRIGGER_TYPE_NONE
				   1 = PMC_TRIGGER_TYPE_RISING
				   2 = PMC_TRIGGER_TYPE_FALLING
				   4 = PMC_TRIGGER_TYPE_HIGH
				   8 = PMC_TRIGGER_TYPE_LOW
		     The assignments of event_type and trigger_type could be
		     found in header file <dt-bindings/soc/tegra-pmc.h>.
- #nvidia,wake-cells : should be 3

Example:

/ SoC dts including file
pmc: pmc {
	compatible = "nvidia,tegra114-pmc";
	reg = <0x7000e400 0x400>;
	clocks = <&tegra_car 261>, <&clk32k_in>;
	clock-names = "pclk", "clk32k_in";
};

/ Tegra board dts file
{
	...
	pmc {
		...
		nvidia,suspend-mode = <0>;
		#nvidia,wake-cells = <3>;
		...
	};
	...
	pmic {
		...
		nvidia,pmc-wakeup = <&pmc
				PMC_WAKE_TYPE_EVENT 18 PMC_TRIGGER_TYPE_LOW>;
		...
	};
	...
	gpio-keys {
		power {
			...
			nvidia,pmc-wakeup = <&pmc
				PMC_WAKE_TYPE_GPIO 16 PMC_TRIGGER_TYPE_NONE>;
			...
		};
	};
};

BootROM I2C commands:

On Tegra210, a set of I2C commands can be programmed into the PMC scratch
registers that will be executed by the BootROM on warm reset.  This can be
used to ensure that various voltage rails are re-initialized to safe levels.
These commands are described in the "bootrom-i2c" sub-node.

Optional properties for bootrom-i2c sub-node:
- nvidia,bus-clear-delay : Delay in us before sending an I2C bus clear.
  Default is 500us.
- nvidia,transfer-delay : Delay in us between independent I2C transfers.
  Default is 500us.
- nvidia,transfer-retries : Maximum number of retries for a particular I2C
  command.  Default is 1.

Command blocks are described in sub-nodes of the bootrom-i2c node.  Command
block sub-nodes must be named "command-block-<n>", with n starting at 0.
Up to 7 command blocks may be specified and up to 63 register address/value
pairs may be specified per command block.

Required properties for command-block sub-nodes:
- nvidia,i2c-controller-id : ID of I2C controller to send I2C commands to.
- nvidia,bus-addr : Bus address of the I2C device to write to.
- nvidia,reg-addr : Array of registers to write to.
- nvidia,reg-data : Array of values to write into the corresponding registers.

Optional properties for command-block sub-nodes:
- nvidia,16-bit-addr : Indicates that the I2C register addresses are 16-bits
  wide.  Otherwise, register address/data are assumed to be 8-bits.
- nvidia,pinmux-id : Pinmux used by the hardware when issuing I2C commands.
                     Defaults to 0. Valid values are described in section 13.6.2
                     "Pinmux Support" of the TegraX1 Technical Reference Manual.

Example:

/ Tegra board dts file
{
	...
	pmc@7000f400 {
		...
		bootrom-i2c {
			nvidia,transfer-delay = <500>;

			command-block-0 {
				nvidia,i2c-controller-id = <4>;
				nvidia,pinmux-id = <0>;
				nvidia,bus-addr = <0x3c>;
				nvidia,reg-addr-0 = <0x16>;
				nvidia,reg-data-0 = <0x20>;
			};
		};
	};
};
```

## Documentation/devicetree/bindings/arm/tegra/nvidia,tegra210-emc.txt
```
Tegra210 External Memory Controller

Properties:
- compatible : Should contain "nvidia,tegra20-emc".
- reg : Should contain 3 register ranges. The EMC register range and per
  channel EMC0/EMC1 register ranges.
- #address-cells : Should be 2
- #size-cells : Should be 2
- clocks : phandle to EMC, EMC shared bus override, and all parent clocks.
- clock-names : name of each clock.
- #thermal-sensor-cells: Should be 0
- ranges : Should be an empty property to indicate identity mapping translation.
- max-clock-frequency : optional, specifies the maximum EMC rate in kHz.
- has-derated-table : optional, an empty property to indicate there will be
  derated tables.

Example:
	memory-controller@7001b000 {
		compatible = "nvidia,tegra210-emc";
		reg = <0x0 0x7001b000 0x0 0x1000>,
		      <0x0 0x7001e000 0x0 0x1000>,
		      <0x0 0x7001f000 0x0 0x1000>;
		#address-cells = <2>;
		#size-cells = <2>;
		clocks = <&tegra_car TEGRA210_CLK_EMC>,
			 <&tegra_car TEGRA210_CLK_PLL_M>,
			 <&tegra_car TEGRA210_CLK_PLL_C>,
			 <&tegra_car TEGRA210_CLK_PLL_P>,
			 <&tegra_car TEGRA210_CLK_CLK_M>,
			 <&tegra_car TEGRA210_CLK_PLL_MB>,
			 <&tegra_car TEGRA210_CLK_OVERRIDE_EMC>;
		clock-names = "emc", "pll_m", "pll_c", "pll_p", "clk_m",
			"pll_mb", "emc_override";
		#thermal-sensor-cells = <0>;
		ranges;
	};
```

## Documentation/devicetree/bindings/edp/nvidia,tegra124-cpu-edp-capping.txt
```
Tegra CPU EDP Management

Any technique for constraining peak current (or power) consumption of
a power rail constitutes EDP management. An EDP management technique
is "dynamic" if its operation depends on parameters which vary at runtime.

This document describes a binding for configuring the dynamic EDP
management algorithm commonly used to manage EDP on the VDD_CPU rail
of Tegra devices.

The algorithm dynamically limits CPU frequency as a function of
temperature, number of cores active, and which cluster is active. (The
algorithm assumes that VDD_CPU powers one or more CPU clusters which
run mutually exclusively). The algorithm computes the maximum
allowable frequency using

- the active cluster's voltage/frequency curve (queried at runtime)
- the VDD_CPU leakage (queried at runtime)
- the active cluster's CPU power model (expressed
     according to nvidia,tegra-ppm.txt)

Required properties:
- compatible: the value "nvidia,tegra124-cpu-edp-capping"
- nvidia,edp-limit: the EDP limit expressed in mA
- nvidia,tz: the related thermal zone device

Optional properties:
- the optional properties supported by binding nvidia,tegra-ppm.txt

Required per-cluster properties:
- the required properties from binding nvidia,tegra-ppm.txt
- nvidia,freq-step: the granularity in kHz of allowable clock frequencies

Example:

	cpu_edp {
		compatible = "nvidia,tegra124-cpu-edp-capping";
		nvidia,freq-step = <12750000>;
		nvidia,tegra-ppm-cdyn = <950000 1399000 2166000 3041000>;
		nvidia,tegra-ppm-leakage_weights = <450 670 870 1000>;
		nvidia,tegra-ppm-min_leakage = <30>;
		nvidia,tegra-ppm-leakage_coeffs = <
			  (-309609464) (197786326) (-40763150) (1613941)
			  .... // 60 additional values omitted for brevity
			>;
		nvidia,edp-limit = <14000>;
		nvidia,tz = <&cpu_therm>;
	};
```

## Documentation/devicetree/bindings/edp/sysedp/nvidia,sysedp-batmon-calc.txt
```
System-EDP Battery Monitor

Periodically monitors the state of battery and computes
the maximum power that the system can draw from the battery
without violating system EDP constraints. It computes the available
power budget based on several platform-specific inputs and a few
runtime variables.

Required properties:
- compatible : "nvidia,tegra124-sysedp-batmon-calc"
- power-supply : The phandle of system power supply device.
- update-interval: The defines the period (in ms) for system to compute
  battery power and to update the available power budget.
- vsys-min: The minimum voltage (in uV) needed for PMIC.
- imax-mode: If exist, the driver will read Imax from battery to compute
  maximum power. If missing, the following properties are required.
    - ocv-curve: The property contains several sets of combinations of
      capacity battery remained and battery open-circuit-voltage (in uV).
      Take <60 7641110> for exmaple, it means the battery
      open-circuit-voltage is 7641.11mV when battery remained capacity is
      60%. Entries must be in descending order wrt capacity and last entry
      must be <0 ...>.
    - maxcurrent-curve: This defines the maximum allowed current (in mA) from
      the battery under specific temperature. The property contains several
      sets of combinations of temperature and current with the format of
      <decC mA>. C is the temperature in decicelcius. mA is the maximum current
      battery can supply under this temperature.
      Take <600 6150> for example, this means that battery can supply 6150mA
      when temperature is 60 degree Celsius.
      Entries must be in descending order wrt temperature and
      last entry must be <... 0>.
    - impedance-curve: An array of battery impedance (in uOhm) under different
      temperatures and capacity.
    - temp-axis: An array of different temperatures (in decicelsius).
    - capacity-axis: An array of capacity battery remains.
    - r-const: This value describes the system impedance (in uOhm).

Example:
	i2c@7000c400 {
		ec: cros-ec@1e {
			i2c_21: i2c-tunnel {
				battery: bq27742@55 {
					compatible = "ti,bq27742";
					reg = <0x55>;
					battery-name = "battery";
				};
			};
		};
	};

	sysedp-batmon-calc {
		compatible = "nvidia,tegra124-sysedp-batmon-calc";
		power-supply = <&battery>;
		update-interval = <30000>;
		vsys-min = <2900000>;
		imax-mode;
	};

	sysedp-batmon-calc {
		compatible = "nvidia,tegra124-sysedp-batmon-calc";
		power-supply = <&battery>;
		update-interval = <30000>;
		vsys-min = <2900000>;
		ocv-curve = <
			100 8372010
			60 7641110
			0 5999850
		>;
		maxcurrent-curve = <
			600 6150
			400 6150
			0 6150
			-300 0
		>;
		impedance-curve = <
			/* 60C	45C	30C	22C	15C	50C	0C	-10C */
			67033	67033	65082	65563	74248	101262	142941	142941	/* 100% */
			67004	67004	65118	64381	73787	100638	142065	142065	/* 80% */
			67103	67103	65371	64000	70778	90388	114825	114825	/* 60% */
			67408	67408	65894	64533	70229	87182	104433	104433	/* 40% */
			68272	68272	67117	65945	71666	89842	108942	108942	/* 20% */
			72328	72328	71869	71538	81803	95724	118174	118174	/* 0% */
		>;
		temp-axis = <600 450 300 220 150 50 0 (-100)>;
		capacity-axis = <100 80 60 40 20 0>;
		r-const = <60000>;
	};
```

## Documentation/devicetree/bindings/thermal/tegra-throttle.txt
```
Tegra thermal throttle devicetree bindings

This device is used for thermal throttle, and has number of properties.

Required properties:
- compatible:	Should be "nvidia,balanced-throttle".
- clocks:	Must be the core shared clocks.
		Should contain an entry for each entry in clock-names.
		See ../clocks/clock-bindings.txt for details.
- clock-names:	core shared clocks, should be:
		cap.throttle.c3bus, cap.throttle.sclk, cap.throttle.emc
- balanced-states	phandle of the balanced throttle state.

====throttle state====
Required properties:
- cpu-freq:	the limit of cpu freq (in KHz) in this throttle state.
Optional properties:
- gpu-freq:	the limit of gpu freq (in KHz) in this throttle state.
		if omitted, it mean no limits for it.
- c3bus-freq:	the limit of c3bus freq (in KHz) in this throttle state.
		if omitted, it mean no limits for it.
- sclk-freq:	the limit of sclk freq (in KHz) in this throttle state.
		if omitted, it mean no limits for it.
- emc-freq:	the limit of emc freq (in KHz) in this throttle state.
		if omitted, it mean no limits for it.

Example:
tj-temperature-throttling {
	compatible = "nvidia,balanced-throttle";
	clocks = <&tegra_car 418>, <&tegra_car 429>, <&tegra_car 459>;
	clock-names = "cap.throttle.c3bus", "cap.throttle.sclk", "cap.throttle.emc";
	balanced-states = <&{/cpu-throttling-state}>;
};

cpu-throttling-state {
	throt-state@0 {
		cpu-freq = <739500>;
		gpu-freq = <550000>;
	};
	throt-state@1 {
		cpu-freq = <714000>;
		c2bus-freq = <555000>;
	};
};
```

## Documentation/devicetree/bindings/thermal/tegra_therm_est.txt
```
Thermal estimator driver.
This driver is used to estimate temperature based on the weighted
sum of a sequence of readings from other sensors.

Required properties:
 - compatible:	"nvidia,tegra124-therm-est".
 - toffset:	Temperature offset for thermal estimation, in milli-celsius.
 - polling-period: Polling wait times for thermal estimation, in milli-seconds.
 - sub-devs:	A sub-node which is a container of devices which
		used to estimate temperature.

Properties in sub-devs node:
 - dev:	device node of the thermal zone device, which the thermal estimation
	based on.
 - coeffs:	An array of coefficients, which are for the history twenty
		temperatures of the thermal zones, so the number of entries
		should be twenty.

Example:
	skin_temp: therm-est {
		compatible = "nvidia,tegra124-therm-est";
		toffset = <9793>;
		polling-period = <1100>;

		#thermal-sensor-cells = <0>;

		sub-devs {
			dev0 {
				dev = <&diode>;
				coeffs = <2 1 1 1 1 1 1 1 1 1 1 0 1 1 0 0 0 0 -1 -7>;
			};

			dev1 {
				dev = <&board>;
				coeffs = <-11 -7 -5 -3 -3 -2 -1 0 0 0 1 1 1 2 2 3 4 6 11 18>;
			};
		};
	};
```

## Documentation/devicetree/bindings/timer/nvidia,tegra210-timer.txt
```
NVIDIA Tegra210 timer

The Tegra210 timer provides 4 29-bit timer channels that directly at the
oscillator clock.

Required properties:

- compatible : should be "nvidia,tegra210-timer".
- reg : Specifies base physical address and size of the registers.
- interrupts : A list of 4 interrupts; one per each of timer channels 10
    through 13
- clocks : Must contain one entry, for the module clock.
  See ../clocks/clock-bindings.txt for details.

timer@60005000 {
	compatible = "nvidia,tegra210-timer";
	reg = <0x0 0x60005000 0x0 0x400>;
	interrupts = <GIC_SPI 176 IRQ_TYPE_LEVEL_HIGH>,
		     <GIC_SPI 177 IRQ_TYPE_LEVEL_HIGH>,
		     <GIC_SPI 178 IRQ_TYPE_LEVEL_HIGH>,
		     <GIC_SPI 179 IRQ_TYPE_LEVEL_HIGH>;
	clocks = <&tegra_car TEGRA210_CLK_TIMER>;
};
```

## Documentation/devicetree/bindings/usb/nvidia,tegra124-xhci.txt
```
NVIDIA Tegra xHCI controller
============================

The Tegra xHCI controller supports both USB2 and USB3 interfaces exposed
by the Tegra XUSB pad controller.

Required properties:
--------------------
 - compatible: For Tegra124, must contain "nvidia,tegra124-xhci".
   Otherwise, must contain '"nvidia,<chip>-xhci", "nvidia,tegra124-xhci"'
   where <chip> is tegra132.
 - reg: Must contain the base and length of the xHCI host registers and XUSB
   IPFS registers.
 - interrupts: Must contain the xHCI host interrupt.
 - clocks: Must contain an entry for each entry in clock-names.
   See ../clock/clock-bindings.txt for details.
 - clock-names: Must include the following entries:
    - xusb_host
    - xusb_host_src
    - xusb_falcon_src
    - xusb_ss
    - xusb_ss_src
    - xusb_ss_div2
    - xusb_hs_src
    - xusb_fs_src
    - pll_u_480m
    - clk_m
    - pll_e
 - resets: Must contain an entry for each entry in reset-names.
   See ../reset/reset.txt for details.
 - reset-names: Must include the following entries:
   - xusb_host
   - xusb_ss
   - xusb_src
   Note that xusb_src is the shared reset for xusb_{ss,hs,fs,falcon,host}_src.
 - mboxes: Must contain an entry for the XUSB mailbox channel.
   See ../mailbox/mailbox.txt for details.
 - mbox-names: Must include the following entries:
   - xusb
 - avddio-pex-supply: PCIe/USB3 analog logic power supply.  Must supply 1.05V.
 - dvddio-pex-supply: PCIe/USB3 digital logic power supply.  Must supply 1.05V.
 - avdd-usb-supply: USB controller power supply.  Must supply 3.3V.
 - avdd-pll-utmip-supply: UTMI PLL power supply.  Must supply 1.8V.
 - avdd-pll-erefe-supply: PLLE reference PLL power supply.  Must supply 1.05V.
 - avdd-usb-ss-pll-supply: PCIe/USB3 PLL power supply.  Must supply 1.05V.
 - hvdd-usb-ss-supply: High-voltage PCIe/USB3 power supply.  Must supply 3.3V.
 - hvdd-usb-ss-pll-e-supply: High-voltage PLLE power supply.  Must supply 3.3V.

Optional properties:
--------------------
 - phys: Must contain an entry for each entry in phy-names.
   See ../phy/phy-bindings.txt for details.
 - phy-names: Should include an entry for each PHY used by the controller.
   Names must be of the form "<type>-<number>" where <type> is one of "utmi",
   "hsic", or "usb3" and <number> is a 0-based index.  On Tegra124, there may
   be up to 3 UTMI, 2 HSIC, and 2 USB3 PHYs.

Example:
--------
	usb-host@0,70090000 {
		compatible = "nvidia,tegra124-xhci";
		reg = <0x0 0x70090000 0x0 0x8000>,
		      <0x0 0x70099000 0x0 0x1000>;
		interrupts = <GIC_SPI 39 IRQ_TYPE_LEVEL_HIGH>;
		clocks = <&tegra_car TEGRA124_CLK_XUSB_HOST>,
			 <&tegra_car TEGRA124_CLK_XUSB_HOST_SRC>,
			 <&tegra_car TEGRA124_CLK_XUSB_FALCON_SRC>,
			 <&tegra_car TEGRA124_CLK_XUSB_SS>,
			 <&tegra_car TEGRA124_CLK_XUSB_SS_DIV2>,
			 <&tegra_car TEGRA124_CLK_XUSB_SS_SRC>,
			 <&tegra_car TEGRA124_CLK_XUSB_HS_SRC>,
			 <&tegra_car TEGRA124_CLK_XUSB_FS_SRC>,
			 <&tegra_car TEGRA124_CLK_PLL_U_480M>,
			 <&tegra_car TEGRA124_CLK_CLK_M>,
			 <&tegra_car TEGRA124_CLK_PLL_E>;
		clock-names = "xusb_host", "xusb_host_src", "xusb_falcon_src",
			      "xusb_ss", "xusb_ss_div2", "xusb_ss_src",
			      "xusb_hs_src", "xusb_fs_src", "pll_u_480m",
			      "clk_m", "pll_e";
		resets = <&tegra_car 89>, <&tegra_car 156>, <&tegra_car 143>;
		reset-names = "xusb_host", "xusb_ss", "xusb_src";
		mboxes = <&xusb_mbox>;
		mbox-names = "xusb";
		phys = <&padctl TEGRA_XUSB_PADCTL_UTMI_P1>, /* mini-PCIe USB */
		       <&padctl TEGRA_XUSB_PADCTL_UTMI_P2>, /* USB A */
		       <&padctl TEGRA_XUSB_PADCTL_USB3_P0>; /* USB A */
		phy-names = "utmi-1", "utmi-2", "usb3-0";
		avddio-pex-supply = <&vdd_1v05_run>;
		dvddio-pex-supply = <&vdd_1v05_run>;
		avdd-usb-supply = <&vdd_3v3_lp0>;
		avdd-pll-utmip-supply = <&vddio_1v8>;
		avdd-pll-erefe-supply = <&avdd_1v05_run>;
		avdd-usb-ss-pll-supply = <&vdd_1v05_run>;
		hvdd-usb-ss-supply = <&vdd_3v3_lp0>;
		hvdd-usb-ss-pll-e-supply = <&vdd_3v3_lp0>;
	};
```

## Documentation/devicetree/bindings/usb/nvidia,tegra210-xudc.txt
```
NVIDIA Tegra XUSB device controller
===================================

The Tegra XUSB device-mode controller supports USB2.0 and SuperSpeed USB3.0.

Required properties:
--------------------
 - compatible: Must contain "nvidia,tegra210-xudc".
 - reg: Must contain the base and length of the XUSB_DEV, FPCI, and IPFS
   registers.
 - interrupts: Must contain the XUSB_DEV interrupt.
 - clocks: Must contain an entry for each entry in clock-names.
   See ../clock/clock-bindings.txt for details.
 - clock-names: Must include the following entries:
    - xusb_dev
    - xusb_ss
    - pll_u_480m
    - pll_e
 - resets: Must contain an entry for each entry in reset-names.
   See ../reset/reset.txt for details.
 - reset-names: Must include the following entries:
   - xusb_dev
   - xusb_ss
 - dvddio-pex-supply: PCIe/USB3 digital logic power supply.  Must supply 1.05V.
 - hvddio-pex-supply: High-voltage PCIe/USB3 logic power supply.
   Must supply 1.8V.
 - avdd-usb-supply: USB controller power supply.  Must supply 3.3V.
 - avdd-pll-utmip-supply: UTMI PLL power supply.  Must supply 1.8V.
 - dvdd-usb-ss-pll-supply: PCIe/USB3 PLL power supply.  Must supply 1.05V.
 - hvdd-usb-ss-pll-e-supply: High-voltage PLLE power supply.  Must supply 1.8V.
 - extcon-cables: Must contain an entry for each entry in extcon-cable-names.
 - extcon-cable-names: Should include the following entries:
   - data-role

Optional properties:
--------------------
 - phys: Must contain an entry for each entry in phy-names.
   See ../phy/phy-bindings.txt for details.
 - phy-names: Should include an entry for each PHY used by the controller:
   - utmi
   - usb3

Example:
--------
	usb-device@0,700d0000 {
		compatible = "nvidia,tegra210-xudc";
		reg = <0x0 0x700d0000 0x0 0x8000>,
		      <0x0 0x700d8000 0x0 0x1000>,
		      <0x0 0x700d9000 0x0 0x1000>;
		interrupts = <GIC_SPI 44 IRQ_TYPE_LEVEL_HIGH>;
		clocks = <&tegra_car TEGRA124_CLK_XUSB_DEV>,
			 <&tegra_car TEGRA124_CLK_XUSB_SS>,
			 <&tegra_car TEGRA124_CLK_PLL_U_480M>,
			 <&tegra_car TEGRA124_CLK_PLL_E>;
		clock-names = "xusb_dev", "xusb_ss", "pll_u_480m", "pll_e";
		resets = <&tegra_car 95>, <&tegra_car 156>;
		reset-names = "xusb_dev", "xusb_ss";

		phys = <&padctl TEGRA_XUSB_PADCTL_UTMI_P0>,
		       <&padctl TEGRA_XUSB_PADCTL_USB3_P0>;
		phy-names = "utmi", "usb3";

		extcon-cables = <&vbus_extcon>;
		extcon-cable-names = "data-role";

		avdd-usb-supply = <&pp3300>;
		dvddio-pex-supply = <&avddio_1v05>;
		hvddio-pex-supply = <&pp1800>;
		avdd-pll-utmip-supply = <&pp1050_avdd>;
		dvdd-usb-ss-pll-supply = <&avddio_1v05>;
		hvdd-usb-ss-pll-e-supply = <&pp1800>;
	};
```

## Documentation/devicetree/bindings/video/nvidia,tegra_camera_platform.txt
```
NVIDIA Camera Platform Sensor Module Binding

Required properties:
- badge: platform + position + part number
- position: rear/front
- orientation: Mount orientation
- pcl_id: PCL support driver, GUID

Optional properties:
- compatible: Should be "nvidia, tegra-camera-platform"

Example
module1{
	badge = "A44_front_4BF215T1";
	position = "front";
	orientation = "0";
	drivernode0 {
		pcl_id = "s_IMX208";
	};
};
```

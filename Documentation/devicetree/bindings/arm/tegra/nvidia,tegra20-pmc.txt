## Documentation/devicetree/bindings/edp/sysedp/nvidia,sysedp-dynamic-capping.txt
```
System-EDP Dynamic Capping

It receives the power constraint in milliwatt (mW) from sysedp,
then it limits the CPU, GPU, and EMC frequencies to ensure that
system will operate in the given budget.

Required properties:
- compatible: "nvidia,tegra124-sysedp-dynamic-capping"
- clocks : Must be the battery-emc shared clock.
  Should contain an entry for each entry in clock-names.
  See ../clocks/clock-bindings.txt for details.
- clock-names : Must set as cap-battery-emc.
  Note that the order of AP Power must start with the smallest power and
  should increase for each entry.
- nvidia,core-gain: The percentage of gain applied to the AP+DRAM budget power.
  A value of 100 means to multiply by 1.0.
- nvidia,init-req-watts defines the initial AP+DRAM budget before the
  geting a calculated budget from the sysedp module.
- nvidia,throttle-depth: The percentage of gain applied to the throttle power.
  A value of 100 means to multiply by 1.0.  Expected values are between 0-100%.
- nvidia,cap-method: The calculation to use when determining which corecap
  entry is associated with the AP+DRAM budget. Available values are:
  SYSEDP_CAP_METHOD_DEFAULT, SYSEDP_CAP_METHOD_DIRECT,
  SYSEDP_CAP_METHOD_SIGNAL, and SYSEDP_CAP_METHOD_RELAX.
  For systems with voltage comparators, the value should be SYSEDP_CAP_METHOD_RELAX.
  For systems without voltage comparators, but with modem overcurrent signals,
  the value should be SYSEDP_CAP_METHOD_SIGNAL.
  For all other systems, the value should be set to SYSEDP_CAP_METHOD_DIRECT.

Required nodes:
- corecaps: This node contains a set of subnodes describing clocks capablity,
  under different required power.

Required properties of each corecap node:
- ap-power: AP power (milliwatts) required by the AP+DRAM when the CPU power
  and GPU and EMC frequencies are capped.
- cpu-pri-cpu-max-power: Maximum power (milliwatts) given to the CPU
  when the CPU has the priority.
- cpu-pri-gpu-max-cap: Maximum GPU frequency (kHz) (or Max Power (mW)) allowed
  when the CPU has the priority. (See nvidia,gpu-cap-as-mw).
- cpu-pri-emc-max-freq: Maximum EMC frequency (kHz) allowed when
  the CPU has the priority.
- gpu-pri-cpu-max-power: Maximum power (milliwatts) given to the CPU
  when the GPU has the priority.
- gpu-pri-gpu-max-cap: Maximum GPU frequency (kHz) (or Max Power (mW)) allowed
  when the GPU has the priority. (See nvidia,gpu-cap-as-mw).
- gpu-pri-emc-max-freq: Maximum EMC frequency (kHz) allowed when
  the GPU has the priority.
- throttle-power: The amount of power (milliwatts) returned to the system
  when the SOC_THERM OC signal throttles the CPU and GPU frequencies.
  This is the amount of power with 100% throttle depth.

  Note that the order of AP Power must start with the smallest power and
  should increase for each subnodes.

Optional properties of each corecap node:
- cpu-pri-gpu-supp-freq: Maximum GPU supplemental frequency (kHz) allowed
  when the CPU has the priority. (See nvidia,gpu-supplement).
- gpu-pri-gpu-supp-freq: Maximum GPU supplemental frequency (kHz) allowed
  when the GPU has the priority. (See nvidia,gpu-supplement).

+Optional properties:
- nvidia,gpu-cap-as-mw: if present, this property indicates that the
  GPU caps "cpu/gpu-pri-gpu-max-cap"are power limits in mW as opposed
  to frequency limits in kHz.
- nvidia,gpu_supplement: This property must to be used in tandem with
  nvidia,gpu-cap-as-mw. If present, this property indicates that there
  are two additional properties in the corecap node, which contain
  the gpu frequencies in kHz corresponding to a typical part at 70C.
  These properties are required if the GPU caps are expressed in terms of mW
  instead of kHz, to supplement the information available to choose
  between GPU priority mode vs CPU Priority Mode.

Example:
	sysedp-dynamic-capping {
		compatible = "nvidia,tegra124-sysedp-dynamic-capping";
		clocks = <&tegra_car TEGRA124_CLK_BATTERY_EMC>;
		clock-names = "cap-battery-emc";
		nvidia,core-gain = <100>;
		nvidia,init-req-watts = <20000>;
		nvidia,throttle-depth = <75>;
		nvidia,cap-method = <SYSEDP_CAP_METHOD_RELAX>;
		corecaps {
			corecap0: corecap@0 {
				ap-power = <5000>; //power in mW
				cpu-pri-cpu-max-power = <3000>;  //power in mW
				cpu-pri-gpu-max-cap = <180000>;  //freq in kHz
				cpu-pri-emc-max-freq = <933000>; //freq in kHz
				gpu-pri-cpu-max-power = <3000>;  //power in mW
				gpu-pri-gpu-max-cap = <180000>;  //freq in kHz
				gpu-pri-emc-max-freq = <933000>; //freq in kHz
				throttle-power = <2604>;
			};
		};
	};

Example 2:
	sysedp-dynamic-capping {
		compatible = "nvidia,tegra124-sysedp-dynamic-capping";
		clocks = <&tegra_car TEGRA124_CLK_BATTERY_EMC>;
		clock-names = "cap-battery-emc";
		nvidia,core-gain = <100>;
		nvidia,init-req-watts = <20000>;
		nvidia,throttle-depth = <75>;
		nvidia,cap-method = <SYSEDP_CAP_METHOD_RELAX>;
		nvidia,gpu-cap-as-mw;
		nvidia,gpu-supplement;
		corecaps {
			corecap0: corecap@0 {
				ap-power = <5000>; //power in mW
				cpu-pri-cpu-max-power = <3000>;  //power in mW
				cpu-pri-gpu-max-cap = <1200>;    //power in mW
				cpu-pri-emc-max-freq = <933000>; //freq in kHz
				gpu-pri-cpu-max-power = <3000>;  //power in mW
				gpu-pri-gpu-max-cap = <1200>;    // power in mW
				gpu-pri-emc-max-freq = <933000>; //freq in kHz
				throttle-power = <2604>; //power in mW
				cpu-pri-gpu-supp-freq = <77>; //freq in kHz
				gpu-pri-gpu-supp-freq = <77>; //freq in kHz
			};
		};
	};
```

## Documentation/devicetree/bindings/edp/sysedp/nvidia,sysedp-reactive-capping.txt
```
System-EDP Reactive Capping:

It periodically monitors how often SOC_THERM is throttling,
if too often, it can request more power for itself.

Required properties:
- compatible: "nvidia,tegra124-sysedp-reactive-capping"
- nvidia,max-capping-mw: This defines the maximum allowed power for this consumer
  in milliwatts.
- nvidia,step-alarm-mw: When the interrupt is triggered, increase the consumer's
  power by this amount in milliwatts.
- nvidia,step-relax-mw: After relax_ms time since the last interrupt has fired,
  reduce this consumer's required power by this amount in milliwatts.
- nvidia,relax_ms: This defines the delay in milliseconds after an interrupt
  triggers before relaxing this consumer's power requirements.
- interrupt-parent: This points to the parent device that will own the
  translation of the interrupt lines.
- interrupts: This provides the mapping to the parent which will translate
  the interrupt into the virtual irq value and flags used by
  request_threaded_irq(). Only 1 interrupt (2 values) should be defined.
- sysedpc,name: This is the name of the sysedp consumer defined

Example:
	sysedp_reactive_capping@1 {
		compatible = "nvidia,tegra124-sysedp-reactive-capping";
		nvidia,max-capping-mw = <15000>;
		nvidia,step-alarm-mw = <1000>;
		nvidia,step-relax-mw = <500>;
		nvidia,relax-ms = <250>;
		interrupt-parent = <&soctherm>;
		interrupts = <1 0x2002>;

		sysedpc,name = "voltmon_oc1";
	};
```

## Documentation/devicetree/bindings/edp/sysedp/nvidia,sysedp.txt
```
System-EDP

It handles the bookkeeping of each device state and tracks the
available power budget.

Required properties:
- compatible: "nvidia,tegra124-sysedp"

Optional properties:
- nvidia,margin: This defines the margin (in mW) when calculating the budget
  for dynamic capping.
- nvidia,min-budget: This defines the minimum budget (in mW) for dynamic capping.
- nvidia,initial-budget: This is the initial power budget (in mW).
  If the system does not include sysedp_batmon_calc device, this budget will
  be used as a fixed budget for the system.  If this option is not present,
  the initial budget will be set to 1000000 mW.

Required nodes:
- consumers: This node contains a set of subnodes describing different
  devices on the system and their power consumption states.

Optional subnodes of consumers:
- consumerX - These nodes define the power consumption state for one
  consumer device on the system.

Required properties of each consumerX node:
- nvidia,consumer: Node of the consumer device.
- nvidia,states: This property lists the operating power state of the consumer
  in milliwatts. For example, if "nvidia,states" is set to "<0 300>", then
  that consumer will consume either 0mW or 300mW depending on the state set
  by that consumer.
- nvidia,consumer-always-on: If exist, this consumer will be created by sysedp
  framework ,and always be turned on in maximum power state.

Example:
	sysedp {
		compatible = "nvidia,tegra124-sysedp";
		nvidia,margin = <0>;
		nvidia,min-budget = <0>;
		nvidia,initial-budget = <30000>;

		consumers {
			consumer1 {
				nvidia,consumer = <&rear-camera>;
				nvidia,states = <0 300>;
			};
			consumer2 {
				nvidia,consumer = <&front_camera>;
				nvidia,states = <0 150>;
			};
			consumer3 {
				nvidia,consumer = <&speaker>;
				nvidia,states = <0 1080>;
			};
			consumer4 {
				nvidia,consumer = <&wifi>;
				nvidia,states = <0 1020>;
			};
			consumer5 {
				nvidia,consumer = <&backlight>;
				nvidia,states = <0 125 250 375 500 625 750 875 1000 1125 1250>;
			};
			consumer6 {
				nvidia,consumer = <&sdhci-2>;
				nvidia,states = <0 966>;
			};
			consumer7 {
				nvidia,consumer = <&sdhci-3>";
				nvidia,states = <0 966>;
			};
			consumer8 {
				nvidia,consumer = <&led>;
				nvidia,states = <0 350 700 1050 1400 1750 2100 2450 2800 3150 3500>;
			};
			consumer9 {
				nvidia,consumer = <&modem>;
				nvidia,states = <0 4100>;
			};
		};
	};
```

## Documentation/devicetree/bindings/fuse/nvidia,tegra20-kfuse.txt
```
NVIDIA Tegra KFUSE block

The KFUSE module stores encrypted HDCP keys in a large array of fuses.
These keys are used to protect audio/video content over an HDMI or DP
connection.

Required properties:
- compatible: Should be one of the following:
  - "nvidia,tegra20-kfuse": for Tegra20 and Tegra30
  - "nvidia,tegra114-kfuse": for Tegra114, Tegra124 and Tegra132
  - "nvidia,tegra210-kfuse": for Tegra210
- reg: Should contain a single entry that specifies the physical address and
  length of the KFUSE registers.
- clocks: Must contain an entry for each entry in the clock-names property.
  See ../clocks/clock-bindings.txt for details.
- clock-names: Must include the following entries:
  - "kfuse"
- resets: Must contain an entry for each entry in the reset-names property.
- reset-names: Must include the following entries:
  - "kfuse"

Example:

	kfuse@0,7000fc00 {
		compatible = "nvidia,tegra210-kfuse";
		reg = <0x0 0x7000fc00 0x0 0x400>;
		clocks = <&tegra_car TEGRA210_CLK_KFUSE>;
		clock-names = "kfuse";
		resets = <&tegra_car 40>;
		reset-names = "kfuse";
	};
```

## Documentation/devicetree/bindings/i2c/nvidia,tegra20-i2c.txt
```
NVIDIA Tegra20/Tegra30/Tegra114 I2C controller driver.

Required properties:
- compatible : should be:
	"nvidia,tegra114-i2c"
	"nvidia,tegra30-i2c"
	"nvidia,tegra20-i2c"
	"nvidia,tegra20-i2c-dvc"
	"nvidia,tegra210-i2c-vi"
	"nvidia,tegra210-i2c-dpaux"
  Details of compatible are as follows:
  nvidia,tegra20-i2c-dvc: Tegra20 has specific I2C controller called as DVC I2C
	controller. This only support master mode of I2C communication. Register
	interface/offset and interrupts handling are different than generic I2C
	controller. Driver of DVC I2C controller is only compatible with
	"nvidia,tegra20-i2c-dvc".
  nvidia,tegra20-i2c: Tegra20 has 4 generic I2C controller. This can support
	master and slave mode of I2C communication. The i2c-tegra driver only
	support master mode of I2C communication. Driver of I2C controller is
	only compatible with "nvidia,tegra20-i2c".
  nvidia,tegra30-i2c: Tegra30 has 5 generic I2C controller. This controller is
	very much similar to Tegra20 I2C controller with additional feature:
	Continue Transfer Support. This feature helps to implement M_NO_START
	as per I2C core API transfer flags. Driver of I2C controller is
	compatible with "nvidia,tegra30-i2c" to enable the continue transfer
	support. This is also compatible with "nvidia,tegra20-i2c" without
	continue transfer support.
  nvidia,tegra114-i2c: Tegra114 has 5 generic I2C controller. This controller is
	very much similar to Tegra30 I2C controller with some hardware
	modification:
	 - Tegra30/Tegra20 I2C controller has 2 clock source called div-clk and
	   fast-clk. Tegra114 has only one clock source called as div-clk and
	   hence clock mechanism is changed in I2C controller.
	 - Tegra30/Tegra20 I2C controller has enabled per packet transfer by
	   default and there is no way to disable it. Tegra114 has this
	   interrupt disable by default and SW need to enable explicitly.
	Due to above changes, Tegra114 I2C driver makes incompatible with
	previous hardware driver. Hence, tegra114 I2C controller is compatible
	with "nvidia,tegra114-i2c".
  nvidia,tegra210-i2c-vi: Tegra210 has specific I2C controller for the purposes
	of VI block. It has different register addressing layout and requires
	additional initialization before issuing transfers. Moreover, it needs
	two additional clocks and external regulator.
  nvidia,tegra210-i2c-dpaux: Tegra210 has an I2C controller which is part of
	the DPAUX block.  It requires additional initialization before issuing
	transfers and two additional clocks.
- reg: Should contain I2C controller registers physical address and length.
  For the Tegra210 DPAUX I2C, the DPAUX controller registers physical address
  and length must also be specified.
- interrupts: Should contain I2C controller interrupts.
- address-cells: Address cells for I2C device address.
- size-cells: Size of the I2C device address.
- clocks: Must contain an entry for each entry in clock-names.
  See ../clocks/clock-bindings.txt for details.
- clock-names: Must include the following entries:
  Tegra20/Tegra30:
  - div-clk
  - fast-clk
  Tegra114:
  - div-clk
  Tegra210 VI I2C:
  - div-clk
  - slow-clk
  - host1x-clk
  Tegra210 DPAUX I2C:
  - div-clk
  - dpaux-clk
  - sor-clk
- avdd-supply: (Tegra210 VI I2C only) External regulator driving the analog
  interface. See ../regulator/regulator.txt for details.
- resets: Must contain an entry for each entry in reset-names.
  See ../reset/reset.txt for details.
- reset-names: Must include the following entries:
  - i2c
- dmas: Must contain an entry for each entry in clock-names.
  See ../dma/dma.txt for details.
- dma-names: Must include the following entries:
  - rx
  - tx
- nvidia,multimaster-mode: Should be set if the bus is operating in
  multimaster mode.

Optional properties:
- nvidia,controller-id: ID of controller when referred to in
                        hardware registers.
- nvidia,scl-gpio: GPIO for SCL line used for bus clear.
- nvidia,sda-gpio: GPIO for SDA line used for bus clear.

Example:

	i2c@7000c000 {
		compatible = "nvidia,tegra20-i2c";
		reg = <0x7000c000 0x100>;
		interrupts = <0 38 0x04>;
		#address-cells = <1>;
		#size-cells = <0>;
		clocks = <&tegra_car 12>, <&tegra_car 124>;
		clock-names = "div-clk", "fast-clk";
		resets = <&tegra_car 12>;
		reset-names = "i2c";
		dmas = <&apbdma 16>, <&apbdma 16>;
		dma-names = "rx", "tx";
		nvidia,multimaster-mode;
		nvidia,controller-id = <0>;
		status = "disabled";
	};
```

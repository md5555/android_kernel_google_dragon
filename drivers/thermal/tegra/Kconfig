## ubuntu/compcache/Kconfig
```kconfig
menu "Compcache options"

config BLK_DEV_COMPCACHE
	tristate "Compressed RAM based swap device"
	default m
	select TLSF
	select LZO_COMPRESS
	select LZO_DECOMPRESS
	help
	  This creates RAM based block device which acts as swap disk. Pages
	  swapped to this disk are compressed and stored in memory itself.
	  Project Home: http://code.google.com/p/compcache/

config BLK_DEV_COMPCACHE_DEBUG
	default n
	depends on BLK_DEV_COMPCACHE
	bool "Enable debugging"
	help
	  This causes negligible performance loss and size increase.
	  If unsure, say Y.

config BLK_DEV_COMPCACHE_STATS
	default n
	depends on BLK_DEV_COMPCACHE
	bool "Enable statistics"
	help
	  Creates /proc/compcache to export various statistics.
	  This adds about 4K to size with negligible performance loss.
	  If unsure, say Y.
endmenu

menu "Two Level Segregate Fit Allocator"
 
config TLSF
	tristate "TLSF Allocator"
	default m
	help
	  Two Level Segregate Fit Allocator. Its fast and gives low
	  fragmentation. See:
		http://rtportal.upv.es/rtmalloc/
		http://code.google.com/p/compcache/wiki/TLSFAllocator
	  for more information.

config TLSF_DEBUG
	default n
	depends on TLSF
	bool "Enable TLSF allocator debugging"
	help
	  Enable TLSF debugging.
	  This causes negligible performance loss and size increase.
	  If unusure, say Y. 

config TLSF_STATS
	default n
	depends on TLSF
	bool "Collect TLSF statistics"
	help
	  Creates /proc/tlsfinfo to export various tlsf statistics.
	  This adds about 30K to size with significant performance loss.
	  If unsure, say N.
endmenu
```

## ubuntu/dm-loop/Kconfig
```kconfig
config DM_LOOP
	tristate "Loop target (EXPERIMENTAL)"
	depends on BLK_DEV_DM && EXPERIMENTAL
	---help---
	  This device-mapper target allows you to treat a regular file as
	  a block device.

	  If unsure, say N.
```

## ubuntu/e1000e/Kconfig
```kconfig
config E1000E_NEW
	tristate "Intel(R) PRO/1000 PCI-Express Gigabit Ethernet support"
	depends on PCI && (!SPARC32 || BROKEN) && !E1000E
	default m
	---help---
	  This driver supports the PCI-Express Intel(R) PRO/1000 gigabit
	  ethernet family of adapters. For PCI or PCI-X e1000 adapters,
	  use the regular e1000 driver For more information on how to
	  identify your adapter, go to the Adapter & Driver ID Guide at:

	  <http://support.intel.com/support/network/adapter/pro100/21397.htm>

	  For general information and support, go to the Intel support
	  website at:

	  <http://support.intel.com>

	  To compile this driver as a module, choose M here. The module
	  will be called e1000e.

config E1000E_ENABLED
	def_bool E1000E_NEW != n
```

## ubuntu/et131x/Kconfig
```kconfig
config NET_ET131X
	tristate "Agere Systems 10/100/1000 Base-T Ethernet Driver for the ET1301 and ET131x series MACs"
	depends on PCI && NET
```

## ubuntu/gfs/Kconfig
```kconfig
config GFS_FS
	tristate "GFS file system support"
	select FS_POSIX_ACL
	select CRC32
	help
	  A cluster filesystem.

	  Allows a cluster of computers to simultaneously use a block device
	  that is shared between them (with FC, iSCSI, NBD, etc...).  GFS reads
	  and writes to the block device like a local filesystem, but also uses
	  a lock module to allow the computers coordinate their I/O so
	  filesystem consistency is maintained.  One of the nifty features of
	  GFS is perfect consistency -- changes made to the filesystem on one
	  machine show up immediately on all other machines in the cluster.

	  To use the GFS filesystem, you will need to enable one or more of
	  the below locking modules. Documentation and utilities for GFS can
	  be found here: http://sources.redhat.com/cluster
```

## ubuntu/gnbd/Kconfig
```kconfig
config GNBD
	tristate "GFS Network Block Device"
	default m
	depends on SYSFS && NET && INET
```

## ubuntu/heci/Kconfig
```kconfig
config HECI
	tristate "Intel(R) Manageability Engine Interface Driver"
	default m
```

## ubuntu/misc/Kconfig
```kconfig
config FSAM7400
	tristate "SW RF kill switch for Fujitsu Siemens Amilo M 7400"
	default m
	select CHECK_SIGNATURE

config LMPCM_USB
	tristate "USB Logitech MediaPlay Cordless Mouse driver"
	default m
	depends on USB
```

## ubuntu/misc/media/Kconfig
```kconfig
menu "Media related drivers"

config USB_OV511_NEW
	tristate "OmniVision OV511 Camera-to-USB Bridge Driver"
	default m
	depends on USB && VIDEO_V4L2

endmenu
```

## ubuntu/misc/wireless/Kconfig
```kconfig
menu "Wireless Drivers"

config WIRELESS_ACX
	tristate "TI ACX1xx based wireless cards (CardBus/PCI/USB)"
	default m
	depends on NET && IEEE80211

endmenu
```

## ubuntu/tlsup/Kconfig
```kconfig
config TLSUP
	tristate "Toshiba ACPI laptop driver"
	depends on ACPI && X86
	default m
```

## ubuntu/unionfs/Kconfig
```kconfig
config FS_UNIONFS
	tristate "UnionFS 1.4 Legacy"
	default m
	help
	  This is the v1.4 module, forward ported and beaten into
	  AppArmor submission. It is a fallback for aufs in case it ends
	  up being broken. We know this one works for the LiveCD, so
	  this is to keep the release managers from having to spend
	  long nights and pushing off deadlines.
```

## ubuntu/via_chrome9/Kconfig
```kconfig
config DRM_VIA_CHROME9
	tristate "Via unichrome9 video cards"
	depends on DRM
	help
	  Choose this option if you have a Via unichrome9 or compatible video
	  chipset. If M is selected the module will be called via_chrome9.
```
